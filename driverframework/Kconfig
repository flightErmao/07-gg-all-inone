## driverframework/L0_task/04_project/01_basic/TASK_04_DISTRIBUTE/Kconfig
```kconfig
menuconfig PROJECT_MINIFLY_TASK04_DISTRIBUTE_EN
    bool "ENABLE: PROJECT_MINIFLY_TASK04_DISTRIBUTE_EN"
    default n
    help
       open distribute task
    if PROJECT_MINIFLY_TASK04_DISTRIBUTE_EN
        config PROJECT_MINIFLY_TASK04_DISTRIBUTE_COMMAND_EN
        bool "ENABLE: PROJECT_MINIFLY_TASK04_DISTRIBUTE_COMMAND_EN"
        default n
        help
            "enable command parsing"

        config PROJECT_MINIFLY_TASK04_DISTRIBUTE_ACK_EN
        bool "ENABLE: PROJECT_MINIFLY_TASK04_DISTRIBUTE_ACK_EN"
        default n
        help
            "enable ack parsing"

        config PROJECT_MINIFLY_TASK04_DISTRIBUTE_RCDATA_EN
        bool "ENABLE: PROJECT_MINIFLY_TASK04_DISTRIBUTE_RCDATA_EN"
        default n
        help
            "enable rc data parsing"

        config PROJECT_MINIFLY_TASK04_DISTRIBUTE_POWER_EN
        bool "ENABLE: PROJECT_MINIFLY_TASK04_DISTRIBUTE_POWER_EN"
        default n
        help
            "enable power management parsing"

        config PROJECT_MINIFLY_TASK04_DISTRIBUTE_REMOTE_EN
        bool "ENABLE: PROJECT_MINIFLY_TASK04_DISTRIBUTE_REMOTE_EN"
        default n
        help
            "enable remote control parsing"

        config PROJECT_MINIFLY_TASK04_DISTRIBUTE_PID_EN
        bool "ENABLE: PROJECT_MINIFLY_TASK04_DISTRIBUTE_PID_EN"
        default n
        help
            "enable PID parameter parsing"
    endif
```

## driverframework/L0_task/04_project/01_basic/TASK_06_RC/Kconfig
```kconfig
menuconfig PROJECT_MINIFLY_TASK06_RC_EN
    bool "ENABLE: PROJECT_MINIFLY_TASK06_RC_EN"
    default n
    select PROJECT_MINIFLY_TASK04_DISTRIBUTE_EN
    select PROJECT_MINIFLY_TASK04_DISTRIBUTE_REMOTE_EN
    help
        Enable RC control task that periodically publishes pilot command data via MCN.
        
if PROJECT_MINIFLY_TASK06_RC_EN
    config PROJECT_MINIFLY_TASK06_RC_FAILSAFE_TIMEOUT_MS
        int "RC failsafe timeout in milliseconds"
        default 1000
        range 1000 10000
        help
            Timeout value in milliseconds for RC failsafe protection.
            If RC data is older than this value, the system will disarm and zero all axes.
            
    config PROJECT_MINIFLY_TASK06_RC_ATKP_LOG_EN
        bool "ENABLE: PROJECT_MINIFLY_TASK06_RC_ATKP_LOG_EN"
        default n
        help
            Enable ATKP logging for the RC task.
endif 
```

## driverframework/L0_task/04_project/01_minifly/TASK_01_SENSOR/Kconfig
```kconfig
menuconfig PROJECT_MINIFLY_TASK_SENSOR_EN
    bool "ENABLE: PROJECT_MINIFLY_TASK_SENSOR_EN"
    default n
    help
        Enable sensor test task that periodically calls sensor test interface.
    if PROJECT_MINIFLY_TASK_SENSOR_EN
        config PROJECT_MINIFLY_TASK_SENSOR_IMU_NAME
            string "IMU device name for sensor_minifly task"
            default "mpu6500_minifly"
            help
                IMU device name used by sensor_minifly task. Default is the MPU6500 MINIFLY device name.
        config PROJECT_MINIFLY_TASK_SENSOR_ATKP_LOG_EN
            bool "ENABLE: PROJECT_MINIFLY_TASK_SENSOR_ATKP_LOG_EN"
            default n
            help
                Enable ATKP logging for the sensor task.
        
        config PROJECT_MINIFLY_TASK_SENSOR_TIMER_TRIGGER_EN
            bool "ENABLE: PROJECT_MINIFLY_TASK_SENSOR_TIMER_TRIGGER_EN"
            default n
            help
                Enable timer-triggered sampling for the sensor task. When enabled, a software timer periodically releases an event, and the task blocks waiting for this event before reading IMU data.

        config PROJECT_MINIFLY_TASK_SENSOR_ROTATION
            string "Rotation enum name (e.g. ROTATION_NEGATE_X)"
            default "ROTATION_NEGATE_X"
            help
                Rotation to apply to IMU data after scale and bias removal.

    endif
```

## driverframework/L0_task/04_project/01_minifly/TASK_02_STABLIZE/Kconfig
```kconfig
menuconfig PROJECT_MINIFLY_TASK_STABLIZE_EN
    bool "ENABLE: PROJECT_MINIFLY_TASK_STABLIZE_EN"
    default n

    select PROJECT_MINIFLY_TASK_SENSOR_EN
    select PROJECT_MINIFLY_TASK05_PARAM_EN
    select L1_MIDDLEWARE_01_MODULE_02_MATHS_EN
    select L1_MIDDLEWARE_01_MODULE_04_PID_MINIFLY_EN
    
    help
        Enable stabilize task that periodically calls stabilize interface.
        
    if PROJECT_MINIFLY_TASK_STABLIZE_EN
        config PROJECT_MINIFLY_TASK_STABLIZE_ATKP_LOG_EN
            bool "ENABLE: PROJECT_MINIFLY_TASK_STABLIZE_ATKP_LOG_EN"
            default n
            help
                Enable ATKP logging for the stabilize task.

            if PROJECT_MINIFLY_TASK_STABLIZE_ATKP_LOG_EN
                config PROJECT_MINIFLY_TASK_STABLIZE_LOG_FLYER_ANGLE
                    bool "ENABLE: PROJECT_MINIFLY_TASK_STABLIZE_LOG_FLYER_ANGLE"
                    default n
                    help
                        Enable flyer angle logging for the stabilize task.

                config PROJECT_MINIFLY_TASK_STABLIZE_LOG_ANGLE_DEBUG
                    bool "ENABLE: PROJECT_MINIFLY_TASK_STABLIZE_LOG_ANGLE_DEBUG"
                    default n
                    help
                        Enable angle debug logging for the stabilize task.

                if PROJECT_MINIFLY_TASK_STABLIZE_LOG_ANGLE_DEBUG
                    config PROJECT_MINIFLY_TASK_STABLIZE_LOG_GROUP_ANGLE
                        int "LOG GROUP ID FOR ANGLE DEBUG"
                        range 1 99
                        default 1
                        help
                            Set the group ID for angle debug logging (1-99).
                endif

                config PROJECT_MINIFLY_TASK_STABLIZE_LOG_RATE_DEBUG
                    bool "ENABLE: PROJECT_MINIFLY_TASK_STABLIZE_LOG_RATE_DEBUG"
                    default n
                    help
                        Enable rate debug logging for the stabilize task.

                if PROJECT_MINIFLY_TASK_STABLIZE_LOG_RATE_DEBUG
                    config PROJECT_MINIFLY_TASK_STABLIZE_LOG_GROUP_RATE
                        int "LOG GROUP ID FOR RATE DEBUG"
                        range 1 99
                        default 2
                        help
                            Set the group ID for rate debug logging (1-99).
                endif

                config PROJECT_MINIFLY_TASK_STABLIZE_LOG_ANGLE_PID_DEBUG
                    bool "ENABLE: PROJECT_MINIFLY_TASK_STABLIZE_LOG_ANGLE_PID_DEBUG"
                    default n
                    help
                        Enable angle PID debug logging for the stabilize task.

                if PROJECT_MINIFLY_TASK_STABLIZE_LOG_ANGLE_PID_DEBUG
                    config PROJECT_MINIFLY_TASK_STABLIZE_LOG_GROUP_ANGLE_PID
                        int "LOG GROUP ID FOR ANGLE PID DEBUG"
                        range 1 99
                        default 3
                        help
                            Set the group ID for angle PID debug logging (1-99).
                endif

                config PROJECT_MINIFLY_TASK_STABLIZE_LOG_RATE_PID_DEBUG
                    bool "ENABLE: PROJECT_MINIFLY_TASK_STABLIZE_LOG_RATE_PID_DEBUG"
                    default n
                    help
                        Enable rate PID debug logging for the stabilize task.

                if PROJECT_MINIFLY_TASK_STABLIZE_LOG_RATE_PID_DEBUG
                    config PROJECT_MINIFLY_TASK_STABLIZE_LOG_GROUP_RATE_PID
                        int "LOG GROUP ID FOR RATE PID DEBUG"
                        range 1 99
                        default 4
                        help
                            Set the group ID for rate PID debug logging (1-99).
                endif
            endif

        config PROJECT_MINIFLY_TASK_STABLIZE_DEBUGPIN_EN
            bool "ENABLE: PROJECT_MINIFLY_TASK_STABLIZE_DEBUGPIN_EN"
            default n
            help
                Enable debug pin for the stabilize task.

    endif
```

## driverframework/L0_task/04_project/01_minifly/TASK_03_NRF/Kconfig
```kconfig
menuconfig PROJECT_MINIFLY_TASK_NRF_EN
    bool "ENABLE: PROJECT_MINIFLY_TASK_NRF_EN"
    default n
    help
       open nrf task
    if PROJECT_MINIFLY_TASK_NRF_EN
        config TASK_MINIFLY_TASK_NRF_DEVICE_DEFAULT
        string "the default of send device"
        default "uart2"
        help
            "the default of send device"

        config TASK_MINIFLY_TASK_NRF_BAUD_RATE
        int "the baud rate of send device"
        default 1000000
        help
            "the baud rate of send device"
    endif
```

## driverframework/L0_task/04_project/01_minifly/TASK_05_PARAM/Kconfig
```kconfig
menuconfig PROJECT_MINIFLY_TASK05_PARAM_EN
    bool "ENABLE: PROJECT_MINIFLY_TASK05_PARAM_EN"
    default n
    help
       open param config task
    if PROJECT_MINIFLY_TASK05_PARAM_EN
        config PROJECT_MINIFLY_TASK05_PARAM_DEBUGPIN_EN
        bool "ENABLE: PROJECT_MINIFLY_TASK05_PARAM_DEBUGPIN_EN"
        default n
        help
            "enable param config debug output"
        
        config PROJECT_MINIFLY_TASK05_PARAM_AUTO_SAVE_EN
        bool "ENABLE: PROJECT_MINIFLY_TASK05_PARAM_AUTO_SAVE_EN"
        default y
        help
            "enable auto save param to flash"
    endif
```

## driverframework/L0_task/04_project/01_minifly/TASK_06_RC/Kconfig
```kconfig
menuconfig PROJECT_MINIFLY_TASK06_RC_EN
    bool "ENABLE: PROJECT_MINIFLY_TASK06_RC_EN"
    default n
    select PROJECT_MINIFLY_TASK04_DISTRIBUTE_EN
    select PROJECT_MINIFLY_TASK04_DISTRIBUTE_REMOTE_EN
    help
        Enable RC control task that periodically publishes pilot command data via MCN.
        
if PROJECT_MINIFLY_TASK06_RC_EN
    config PROJECT_MINIFLY_TASK06_RC_DEBUGPIN_EN
        bool "ENABLE: PROJECT_MINIFLY_TASK06_RC_DEBUGPIN_EN"
        default n
        help
            Enable debug output for RC task.
            
    config PROJECT_MINIFLY_TASK06_RC_FAILSAFE_TIMEOUT_MS
        int "RC failsafe timeout in milliseconds"
        default 2000
        range 1000 10000
        help
            Timeout value in milliseconds for RC failsafe protection.
            If RC data is older than this value, the system will disarm and zero all axes.
endif 
```

## driverframework/L0_task/04_project/02_fmt/01_TASK_RC/Kconfig
```kconfig
menuconfig PROJECT_FMT_TASK01_RC_EN
    bool "ENABLE: PROJECT_FMT_TASK01_RC_EN"
    default n
    # select RC_USING_SBUS
    help
        Enable RC test task that reads RC receiver data and outputs channel values.

    if PROJECT_FMT_TASK01_RC_EN
        config PROJECT_FMT_TASK01_RC_DEVICE_DEFAULT
            string "RC device name"
            default "sbus"
            help
                The RC device name to use (e.g. sbus, crsf).

        config PROJECT_FMT_TASK01_RC_ATKP_LOG_EN
            bool "ENABLE: PROJECT_FMT_TASK01_RC_ATKP_LOG_EN"
            default n
            help
                Enable ATKP log for RC data.

        config PROJECT_FMT_TASK01_RC_DEADZONE_PERCENT
            int "RC deadzone percent (x100, e.g. 5 = 0.05 = 5%)"
            default 5
            range 0 50
            help
                RC stick deadzone percentage (multiplied by 100).
                Default: 5 (0.05 = 5% deadzone)
                Range: 0-50 (0% to 50%)
                This creates a dead zone around the center position to ignore small stick movements.

    endif
```

## driverframework/L0_task/04_project/03_fpv/01_TASK_DSHOT/Kconfig
```kconfig
menuconfig PROJECT_MINIFLY_TASK_DSHOT_EN
    bool "ENABLE: PROJECT_MINIFLY_TASK_DSHOT_EN"
    default n
    help
        Enable DShot task which periodically publishes motor RPM command via uMCN
        and writes mapped values to DShot device.
    if PROJECT_MINIFLY_TASK_DSHOT_EN
        config PROJECT_MINIFLY_TASK_DSHOT_TIMER_HZ
            int "DShot task timer frequency (Hz)"
            default 500
            help
                Periodic frequency of DShot task. Task waits timer event, then
                copies the latest uMCN command and writes to DShot device.
        config PROJECT_MINIFLY_TASK_DSHOT_DEBUG_PIN_EN
            bool "ENABLE: PROJECT_MINIFLY_TASK_DSHOT_DEBUG_PIN_EN"
            default n
            help
                Debug pin for DShot task.
        
        config PROJECT_MINIFLY_TASK_DSHOT_ATKP_LOG_EN
            bool "ENABLE: PROJECT_MINIFLY_TASK_DSHOT_ATKP_LOG_EN"
            default n
            help
                Enable ATKP logging for DShot motor data.
        
        config PROJECT_MINIFLY_TASK_DSHOT_ATKP_LOG_GROUP
            int "ATKP log group ID for motor data"
            default 1
            depends on PROJECT_MINIFLY_TASK_DSHOT_ATKP_LOG_EN
            help
                Group ID used for sending motor data via ATKP protocol.
        
        config PROJECT_MINIFLY_TASK_DSHOT_MLOG_EN
            bool "ENABLE: PROJECT_MINIFLY_TASK_DSHOT_MLOG_EN"
            default n
            depends on TASK_TOOL_02_SD_MLOG
            help
                Enable mlog logging for DShot motor data. This will log motor values,
                mapped DShot values, and armed state to SD card via mlog system.
        
        config PROJECT_MINIFLY_TASK_DSHOT_FILTER_DEBUG_EN
            bool "ENABLE: PROJECT_MINIFLY_TASK_DSHOT_FILTER_DEBUG_EN"
            default n
            help
                Enable debug output for motor filter. This will print raw and filtered
                motor values every 100 iterations to help tune filter parameters.
    endif
```

## driverframework/L0_task/04_project/03_fpv/02_HARDWARE_TIMER/Kconfig
```kconfig
menuconfig PROJECT_HARDWARE_TIMER_SENSOR_EN
    bool "ENABLE: Hardware Timer for Sensor Triggering"
    default n
    help
        Enable hardware timer to trigger sensor reading. This provides precise timing control for IMU data acquisition.

    if PROJECT_HARDWARE_TIMER_SENSOR_EN
        config PROJECT_HARDWARE_TIMER_SENSOR_DEV_NAME
            string "Hardware timer device name"
            default "timer10"
            help
                Hardware timer device name used for sensor triggering.
                Default is timer10.

        config PROJECT_HARDWARE_TIMER_SENSOR_FREQ
            int "Hardware timer trigger frequency (Hz)"
            default 3200
            range 100 10000
            help
                Frequency at which the hardware timer triggers sensor reading in Hz.
                Default is 3200 Hz (3.2kHz).
                Typical values: 1000-8000 Hz for most applications.
    endif
```
