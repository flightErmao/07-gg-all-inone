## driverframework/L0_task/04_project/01_basic/TASK_01_SENSOR/Kconfig
```kconfig
menuconfig PROJECT_MINIFLY_TASK_SENSOR_EN
    bool "ENABLE: PROJECT_MINIFLY_TASK_SENSOR_EN"
    default n
    help
        Enable sensor test task that periodically calls sensor test interface.
    if PROJECT_MINIFLY_TASK_SENSOR_EN
        # ======== Basic Configuration ========
        config PROJECT_MINIFLY_TASK_SENSOR_IMU_NAME
            string "IMU device name for sensor_minifly task"
            default "mpu6500_minifly"
            help
                IMU device name used by sensor_minifly task. Default is the MPU6500 MINIFLY device name.
        
        config PROJECT_MINIFLY_TASK_SENSOR_TIMER_TRIGGER_EN
            bool "ENABLE: Timer-Triggered Sampling"
            default n
            help
                Enable timer-triggered sampling for the sensor task. When enabled, a software timer periodically releases an event, and the task blocks waiting for this event before reading IMU data.

        config PROJECT_MINIFLY_TASK_SENSOR_ROTATION
            string "Rotation enum name (e.g. ROTATION_NEGATE_X)"
            default "ROTATION_NEGATE_X"
            help
                Rotation to apply to IMU data after scale and bias removal.

        config PROJECT_MINIFLY_TASK_SENSOR_GYRO_VARIANCE_BASE
            int "Gyro static variance threshold"
            default 5000
            help
                Static variance threshold for gyro bias detection. Used to decide
                when the gyro is stable enough to take the mean as bias.

        # ======== IMU Filter Configuration ========
        menuconfig PROJECT_MINIFLY_TASK_SENSOR_FILTER_EN
            bool "IMU Filter Configuration"
            default y
            help
                Configure IMU filtering parameters including low-pass filters and notch filters.

        if PROJECT_MINIFLY_TASK_SENSOR_FILTER_EN
            # Low-Pass Filter Configuration
            menuconfig PROJECT_MINIFLY_TASK_SENSOR_LPF_EN
                bool "Low-Pass Filter (LPF)"
                default y
                help
                    Enable and configure low-pass filter for IMU data.

            if PROJECT_MINIFLY_TASK_SENSOR_LPF_EN
                config PROJECT_MINIFLY_TASK_SENSOR_GYRO_LPF_CUTOFF_FREQ
                    int "Gyro LPF cutoff frequency (Hz)"
                    default 70
                    range 1 500
                    help
                        Low-pass filter cutoff frequency for gyroscope data in Hz.
                        Typical values: 50-150 Hz for racing drones, 200-300 Hz for high-speed applications.

                config PROJECT_MINIFLY_TASK_SENSOR_ACC_LPF_CUTOFF_FREQ
                    int "Accelerometer LPF cutoff frequency (Hz)"
                    default 30
                    range 1 500
                    help
                        Low-pass filter cutoff frequency for accelerometer data in Hz.
                        Typical values: 20-50 Hz for most applications.
            endif

            # Notch Filter Configuration
            menuconfig PROJECT_MINIFLY_TASK_SENSOR_NOTCH_EN
                bool "Notch Filter"
                default y
                help
                    Enable and configure notch filters to remove specific noise frequencies.

            if PROJECT_MINIFLY_TASK_SENSOR_NOTCH_EN
                config PROJECT_MINIFLY_TASK_SENSOR_NOTCH_GYRO_1_EN
                    bool "Enable Gyro Notch Filter 1"
                    default y
                    help
                        Enable first notch filter for gyroscope data.

                if PROJECT_MINIFLY_TASK_SENSOR_NOTCH_GYRO_1_EN
                    config PROJECT_MINIFLY_TASK_SENSOR_NOTCH_GYRO_1_FREQ
                        int "Gyro Notch 1 center frequency (Hz)"
                        default 119
                        range 1 1000
                        help
                            Center frequency of the first gyro notch filter in Hz.

                    config PROJECT_MINIFLY_TASK_SENSOR_NOTCH_GYRO_1_Q
                        int "Gyro Notch 1 Q factor (x10)"
                        default 20
                        range 1 200
                        help
                            Quality factor of the first gyro notch filter (multiplied by 10).
                            Typical values: 10-50 (represents Q=1.0-5.0).
                endif

                config PROJECT_MINIFLY_TASK_SENSOR_NOTCH_GYRO_2_EN
                    bool "Enable Gyro Notch Filter 2"
                    default y
                    help
                        Enable second notch filter for gyroscope data.

                if PROJECT_MINIFLY_TASK_SENSOR_NOTCH_GYRO_2_EN
                    config PROJECT_MINIFLY_TASK_SENSOR_NOTCH_GYRO_2_FREQ
                        int "Gyro Notch 2 center frequency (Hz)"
                        default 183
                        range 1 1000
                        help
                            Center frequency of the second gyro notch filter in Hz.

                    config PROJECT_MINIFLY_TASK_SENSOR_NOTCH_GYRO_2_Q
                        int "Gyro Notch 2 Q factor (x10)"
                        default 20
                        range 1 200
                        help
                            Quality factor of the second gyro notch filter (multiplied by 10).
                            Typical values: 10-50 (represents Q=1.0-5.0).
                endif

                config PROJECT_MINIFLY_TASK_SENSOR_NOTCH_GYRO_3_EN
                    bool "Enable Gyro Notch Filter 3"
                    default y
                    help
                        Enable third notch filter for gyroscope data.

                if PROJECT_MINIFLY_TASK_SENSOR_NOTCH_GYRO_3_EN
                    config PROJECT_MINIFLY_TASK_SENSOR_NOTCH_GYRO_3_FREQ
                        int "Gyro Notch 3 center frequency (Hz)"
                        default 146
                        range 1 1000
                        help
                            Center frequency of the third gyro notch filter in Hz.

                    config PROJECT_MINIFLY_TASK_SENSOR_NOTCH_GYRO_3_Q
                        int "Gyro Notch 3 Q factor (x10)"
                        default 20
                        range 1 200
                        help
                            Quality factor of the third gyro notch filter (multiplied by 10).
                            Typical values: 10-50 (represents Q=1.0-5.0).
                endif

                config PROJECT_MINIFLY_TASK_SENSOR_NOTCH_ACC_EN
                    bool "Enable Accelerometer Notch Filter"
                    default y
                    help
                        Enable notch filter for accelerometer data.

                if PROJECT_MINIFLY_TASK_SENSOR_NOTCH_ACC_EN
                    config PROJECT_MINIFLY_TASK_SENSOR_NOTCH_ACC_FREQ
                        int "Acc Notch center frequency (Hz)"
                        default 152
                        range 1 1000
                        help
                            Center frequency of the accelerometer notch filter in Hz.

                    config PROJECT_MINIFLY_TASK_SENSOR_NOTCH_ACC_Q
                        int "Acc Notch Q factor (x10)"
                        default 20
                        range 1 200
                        help
                            Quality factor of the accelerometer notch filter (multiplied by 10).
                            Typical values: 10-50 (represents Q=1.0-5.0).
                endif
            endif
        endif

        # ======== DEBUG: ANOTC (ATKP) ========
        menuconfig PROJECT_MINIFLY_TASK_SENSOR_ATKP_LOG_EN
            bool "DEBUG: ANOTC (ATKP) Logging"
            default n
            help
                Enable ATKP logging for the sensor task.

        # ======== DEBUG: MLOG (SD Card) ========
        menuconfig PROJECT_MINIFLY_TASK_SENSOR_MLOG_EN
            bool "DEBUG: MLOG (SD Card) Logging"
            default n
            depends on TASK_TOOL_02_SD_MLOG
            help
                Enable mlog (SD card logging) for the sensor task.

        if PROJECT_MINIFLY_TASK_SENSOR_MLOG_EN
            config PROJECT_MINIFLY_TASK_SENSOR_MLOG_IMU_EN
                bool "ENABLE: IMU Data Logging"
                default n
                help
                    Enable mlog (SD card logging) for IMU data in the sensor task.
        endif

        # ======== DEBUG: PIN ========
        menuconfig PROJECT_MINIFLY_TASK_SENSOR_DEBUGPIN_EN
            bool "DEBUG: PIN (Debug Pin)"
            default n
            help
                Enable debug pin for the sensor task.

    endif
```

## driverframework/L0_task/04_project/01_basic/TASK_02_STABLIZE/Kconfig
```kconfig
menuconfig PROJECT_MINIFLY_TASK_STABLIZE_EN
    bool "ENABLE: PROJECT_MINIFLY_TASK_STABLIZE_EN"
    default n

    select PROJECT_MINIFLY_TASK_SENSOR_EN
    select PROJECT_MINIFLY_TASK05_PARAM_EN
    select L1_MIDDLEWARE_01_MODULE_02_MATHS_EN
    select L1_MIDDLEWARE_01_MODULE_04_PID_MINIFLY_EN
    
    help
        Enable stabilize task that periodically calls stabilize interface.
        
    if PROJECT_MINIFLY_TASK_STABLIZE_EN
        # ======== DEBUG: ANOTC (ATKP) ========
        menuconfig PROJECT_MINIFLY_TASK_STABLIZE_ATKP_LOG_EN
            bool "DEBUG: ANOTC (ATKP) Logging"
            default n
            help
                Enable ATKP logging for the stabilize task.

            if PROJECT_MINIFLY_TASK_STABLIZE_ATKP_LOG_EN
                config PROJECT_MINIFLY_TASK_STABLIZE_LOG_FLYER_ANGLE
                    bool "ENABLE: Flyer Angle Logging"
                    default n
                    help
                        Enable flyer angle logging for the stabilize task.

                config PROJECT_MINIFLY_TASK_STABLIZE_LOG_ANGLE_DEBUG
                    bool "ENABLE: Angle Debug Logging"
                    default n
                    help
                        Enable angle debug logging for the stabilize task.

                    if PROJECT_MINIFLY_TASK_STABLIZE_LOG_ANGLE_DEBUG
                        config PROJECT_MINIFLY_TASK_STABLIZE_LOG_GROUP_ANGLE
                            int "Log Group ID for Angle Debug"
                            range 1 99
                            default 1
                            help
                                Set the group ID for angle debug logging (1-99).
                    endif

                config PROJECT_MINIFLY_TASK_STABLIZE_LOG_RATE_DEBUG
                    bool "ENABLE: Rate Debug Logging"
                    default n
                    help
                        Enable rate debug logging for the stabilize task.

                    if PROJECT_MINIFLY_TASK_STABLIZE_LOG_RATE_DEBUG
                        config PROJECT_MINIFLY_TASK_STABLIZE_LOG_GROUP_RATE
                            int "Log Group ID for Rate Debug"
                            range 1 99
                            default 2
                            help
                                Set the group ID for rate debug logging (1-99).
                    endif

                config PROJECT_MINIFLY_TASK_STABLIZE_LOG_ANGLE_PID_DEBUG
                    bool "ENABLE: Angle PID Debug Logging"
                    default n
                    help
                        Enable angle PID debug logging for the stabilize task.

                    if PROJECT_MINIFLY_TASK_STABLIZE_LOG_ANGLE_PID_DEBUG
                        config PROJECT_MINIFLY_TASK_STABLIZE_LOG_GROUP_ANGLE_PID
                            int "Log Group ID for Angle PID Debug"
                            range 1 99
                            default 3
                            help
                                Set the group ID for angle PID debug logging (1-99).
                    endif

                config PROJECT_MINIFLY_TASK_STABLIZE_LOG_RATE_PID_DEBUG
                    bool "ENABLE: Rate PID Debug Logging"
                    default n
                    help
                        Enable rate PID debug logging for the stabilize task.

                    if PROJECT_MINIFLY_TASK_STABLIZE_LOG_RATE_PID_DEBUG
                        config PROJECT_MINIFLY_TASK_STABLIZE_LOG_GROUP_RATE_PID
                            int "Log Group ID for Rate PID Debug"
                            range 1 99
                            default 4
                            help
                                Set the group ID for rate PID debug logging (1-99).
                    endif
            endif

        # ======== DEBUG: MLOG (SD Card) ========
        menuconfig PROJECT_MINIFLY_TASK_STABLIZE_MLOG_EN
            bool "DEBUG: MLOG (SD Card) Logging"
            default n
            depends on TASK_TOOL_02_SD_MLOG
            help
                Enable mlog (SD card logging) for the stabilize task.

        if PROJECT_MINIFLY_TASK_STABLIZE_MLOG_EN
            config PROJECT_MINIFLY_TASK_STABLIZE_MLOG_RATE_EN
                bool "ENABLE: Rate Data Logging"
                default n
                help
                    Enable mlog (SD card logging) for angle rate data in the stabilize task.

            config PROJECT_MINIFLY_TASK_STABLIZE_MLOG_ANGLE_EN
                bool "ENABLE: Angle Data Logging"
                default n
                help
                    Enable mlog (SD card logging) for angle data in the stabilize task.

            config PROJECT_MINIFLY_TASK_STABLIZE_MLOG_RC_EN
                bool "ENABLE: RC Data Logging"
                default n
                help
                    Enable mlog (SD card logging) for RC data in the stabilize task.
        endif

        # ======== DEBUG: PIN ========
        menuconfig PROJECT_MINIFLY_TASK_STABLIZE_DEBUGPIN_EN
            bool "DEBUG: PIN (Debug Pin)"
            default n
            help
                Enable debug pin for the stabilize task.

        # ======== RC Input Smoothing Filter ========
        menuconfig PROJECT_MINIFLY_TASK_STABLIZE_RC_FILTER_EN
            bool "ENABLE: RC Input Smoothing Filter"
            default y
            help
                Enable low-pass filter for RC input to smooth deadzone transitions.
                This reduces noise in the control loop caused by sudden RC value changes.

            if PROJECT_MINIFLY_TASK_STABLIZE_RC_FILTER_EN
                config PROJECT_MINIFLY_TASK_STABLIZE_RC_FILTER_ALPHA
                    int "RC Filter Alpha (x100)"
                    range 1 100
                    default 20
                    help
                        Low-pass filter coefficient (0.01 - 1.00, stored as integer x100).
                        Larger values = more responsive, smaller = smoother.
                        Default: 20 (0.20)
                        Recommended range: 10-30 (0.10-0.30)
            endif

    endif
```
