## driverframework/Kconfig
```kconfig
menu "DriverFramework Config"
    source "$(PROJECT_ROOT)/driverframework/L0_task/Kconfig"
    source "$(PROJECT_ROOT)/driverframework/L1_middleWare/Kconfig"
    source "$(PROJECT_ROOT)/driverframework/L2_device/Kconfig"
    source "$(PROJECT_ROOT)/driverframework/L3_peripheral/Kconfig"
endmenu
```

## driverframework/L0_task/01-demo/TASK_01_LED_BLINK/Kconfig
```kconfig
menuconfig DEMO_TASK_LED
    bool "ENABLE: DEMO_TASK_LED"
    default n
    help
        Enable LED blink task that periodically calls Simulink model interface.
        
        When enabled, the system creates an independent thread to run the LED blink task,
        with a timer triggering every 500ms to call the Simulink model's step function.
        
    if DEMO_TASK_LED
        config TASK_1_LED_BLINK_PRIORITY
            int "LED Blink Task Priority"
            default 5
            range 1 10
            help
                Set the thread priority for LED blink task.
                Lower values indicate higher priority.

        config TASK_1_LED_BLINK_TIMER_INTERVAL
            int "LED Blink Timer Interval (ms)"
            default 500
            range 100 10000
            help
                Set the timer interval for LED blink task.
                Unit: milliseconds

        config TASK_1_LED_BLINK_PIN
            string "LED0 Pin (e.g. PA0, PC13)"
            default "PC13"
            help
                Enter the LED0 GPIO pin in format like "PA0", "PB1", "PC13".
                The tool will parse it and map to the correct pin number at runtime.

    endif 
```

## driverframework/L0_task/01_demo/TASK_01_LED_BLINK/Kconfig
```kconfig
menuconfig TASK_DEMO_01_LED_BLINK_EN
    bool "ENABLE: TASK_DEMO_01_LED_BLINK_EN"
    default n
    help
        Enable LED blink task that periodically calls Simulink model interface.
        
        When enabled, the system creates an independent thread to run the LED blink task,
        with a timer triggering every 500ms to call the Simulink model's step function.
        
    if TASK_DEMO_01_LED_BLINK_EN
        config TASK_DEMO_01_LED_BLINK_PRIORITY
            int "LED Blink Task Priority"
            default 5
            range 1 10
            help
                Set the thread priority for LED blink task.
                Lower values indicate higher priority.

        config TASK_DEMO_01_LED_BLINK_TIMER_INTERVAL
            int "LED Blink Timer Interval (ms)"
            default 500
            range 100 10000
            help
                Set the timer interval for LED blink task.
                Unit: milliseconds

        config TASK_DEMO_01_LED_BLINK_PIN
            string "LED0 Pin (e.g. PA0, PC13)"
            default "PC13"
            help
                Enter the LED0 GPIO pin in format like "PA0", "PB1", "PC13".
                The tool will parse it and map to the correct pin number at runtime.

    endif 
```

## driverframework/L0_task/01_demo/TASK_02_UART_TEST/Kconfig
```kconfig
menuconfig TASK_DEMO_02_UART_TEST_EN
    bool "ENABLE: TASK_DEMO_02_UART_TEST_EN"
    default n
    help
       open uart test task
    if TASK_DEMO_02_UART_TEST_EN
        config TASK_DEMO_02_UART_TEST_DEVICE_DEFAULT
        string "the default of uart device"
        default "uart1"
        help
            "the default of uart device"

        config TASK_DEMO_02_UART_TEST_BAUD_RATE
        int "the baud rate of uart device"
        default 1000000
        help
            "the baud rate of uart device"
        
        config TASK_DEMO_02_UART_TEST_DEBUGPIN_EN
        bool "ENABLE: TASK_DEMO_02_UART_TEST_DEBUGPIN_EN"
        default n
        help
            "enable debug pin"
    endif 
```

## driverframework/L0_task/01_demo/TASK_03_SPI_TEST/Kconfig
```kconfig
menuconfig TASK_DEMO_03_SPI_TEST_EN
    bool "ENABLE: TASK_DEMO_03_SPI_TEST_EN"
    default n
    select BSP_USING_SPI
    help
        Enable SPI test task for IMU42688 sensor
        
    if TASK_DEMO_03_SPI_TEST_EN
        config TASK_DEMO_03_SPI_TEST_SPI_BUS_NAME
            string "SPI BUS NAME for IMU42688"
            default "spi1"
            help
                SPI bus name for IMU42688 sensor
                
        config TASK_DEMO_03_SPI_TEST_SPI_SLAVE_NAME
            string "SPI SLAVE NAME for IMU42688"
            default "spi10"
            help
                SPI slave name for IMU42688 sensor
                
        config TASK_DEMO_03_SPI_TEST_SPI_CS_PIN_NAME
            string "SPI CS PIN NAME for IMU42688 (e.g. PA4)"
            default "PA4"
            help
                SPI CS pin name for IMU42688 sensor
                
        config TASK_DEMO_03_SPI_TEST_SPI_MAX_HZ
            int "SPI MAX CLOCK (Hz) for IMU42688"
            default 10000000
            range 100000 20000000
            help
                Maximum SPI clock frequency for IMU42688 sensor
                
        config TASK_DEMO_03_SPI_TEST_DEBUGPIN_EN
            bool "ENABLE: DEBUG PIN"
            default n
            help
                Enable debug pin for SPI test
    endif
```

## driverframework/L0_task/02-tools/TASK_03_ANOTC_TELEM/Kconfig
```kconfig
menuconfig TOOL_TASK_ANOTC_TELEM_EN
    bool "ENABLE: TOOL_TASK_ANOTC_TELEM_EN"
    default n
    help
       open anotc task
    if TOOL_TASK_ANOTC_TELEM_EN
        config TOOL_TASK_DEVICE_DEFAULT
        string "the default of send device"
        default "uart1"
        help
            "the default of send device"
    endif
```

## driverframework/L0_task/02_tools/TASK_01_ANOTC_TELEM/Kconfig
```kconfig
menuconfig TASK_TOOL_01_ANOTC_TELEM_EN
    bool "ENABLE: TASK_TOOL_01_ANOTC_TELEM_EN"
    default n
    help
       open anotc task
    if TASK_TOOL_01_ANOTC_TELEM_EN
        config TASK_TOOL_01_ANOTC_TELEM_DEVICE_DEFAULT
        string "the default of send device"
        default "uart2"
        help
            "the default of send device"

        config TASK_TOOL_01_ANOTC_TELEM_BAUD_RATE
        int "the baud rate of send device"
        default 1000000
        help
            "the baud rate of send device"
    endif
```

## driverframework/L0_task/02_tools/TASK_02_SD_MLOG/Kconfig
```kconfig
menuconfig TASK_TOOL_02_SD_MLOG
    bool "ENABLE: TASK_TOOL_02_SD_MLOG"
    default n
    help
       open sd mlog task

    if TASK_TOOL_02_SD_MLOG

        config TASK_TOOL_02_SD_MLOG_TEST_THREAD
            bool "ENABLE: TASK_TOOL_02_SD_MLOG_TEST_THREAD"
            default n
            help
                enable mlog test command and functionality

        config MLOG_TEST_02_SD_MLOG_FREQ_HZ
            int "Mlog test data generation frequency (Hz)"
            depends on TASK_TOOL_02_SD_MLOG_TEST_THREAD
            default 1000
            range 1 2000
                help
                    frequency for generating test data in Hz

    endif
```

## driverframework/L0_task/03-project/01-minifly/TASK_02_STABLIZE/Kconfig
```kconfig
menuconfig TASK_02_STABLIZE
    bool "ENABLE: TASK_02_STABLIZE"
    default n
    select BSP_USING_MPU6500_MINIFLY
    help
        Enable sensor test task that periodically calls sensor test interface.
    if TASK_02_STABLIZE
        config TASK_STABLIZE_IMU_NAME
            string "IMU device name for stablize task"
            default "mpu6500_minifly"
            help
                IMU device name used by stablize task. Default is the MPU6500 MINIFLY device name.

    endif
```

## driverframework/L0_task/03_work/TASK_01_GPS_TEST/Kconfig
```kconfig
menuconfig WORK_TASK_GPS_TEST_EN
    bool "ENABLE: WORK_TASK_GPS_TEST_EN"
    default n
    help
        Enable GPS test task that periodically calls GPS test interface.
        
        When enabled, the system creates an independent thread to run the GPS test task,
        with a timer triggering every 1000ms to call the GPS test step function.
```

## driverframework/L0_task/03_work/TASK_02_BARO_SHOW/Kconfig
```kconfig
menuconfig WORK_TASK_BARO_REPORT_EN
    bool "ENABLE: WORK_TASK_BARO_REPORT_EN"
    default n
    help
       open baro report task

    if WORK_TASK_BARO_REPORT_EN

        config TASK_BARO_DEVICE_NAME
            string "Barometer device name"
            default "spl06_001"
            help
                Barometer device name used by rt_device_find.
                Valid values: spl06_001, spa06_003, spl16_001, dps368.

        config TASK_BARO_SEND_DATA_ANOTC
            bool "Enable send data to ANOTC telemetry"
            default y            
            help
                Enable sending barometer data to ANOTC telemetry system

        config TASK_BARO_ATKP_LOG_EN
            bool "Enable ATKP logging for barometer data"
            default n
            help
                Enable ATKP logging for barometer data transmission

        if TASK_BARO_ATKP_LOG_EN
            config TASK_BARO_ATKP_CHANNEL
                int "ATKP channel number for barometer data"
                range 1 8
                default 1
                help
                    ATKP channel number (1-8) for sending barometer data
        endif

    endif 
```

## driverframework/L0_task/03_work/TASK_02_BARO_TEST/Kconfig
```kconfig
menuconfig WORK_TASK_BARO_REPORT_EN
    bool "ENABLE: WORK_TASK_BARO_REPORT_EN"
    default n
    help
       open baro report task

    if WORK_TASK_BARO_REPORT_EN

        config TASK_SEND_DATA_ANOTC
            bool "Enable send data to ANOTC telemetry"
            default y            
            help
                Enable sending barometer data to ANOTC telemetry system

        config TASK_CONFIG_BARO_PRINTF
            bool "Enable barometer data printf"
            default n            
            help
                Enable printing barometer data to console

        choice BARO_SENSOR_SELECTION
            prompt "Select barometer sensor"
            default BARO_REPORT_USING_SPL16_001            
            help
                Select which barometer sensor to use

            config BARO_REPORT_USING_SPL16_001
                bool "SPL16_001 barometer"
                help
                    Use SPL16_001 barometer sensor

            config BARO_REPORT_USING_DPS368
                bool "DPS368 barometer"
                help
                    Use DPS368 barometer sensor

            config BARO_REPORT_USING_SPA06_003
                bool "SPA06_003 barometer"
                help
                    Use SPA06_003 barometer sensor
        endchoice

        comment "Select barometer and device name in L1_module -> MODULE_BARO_REPORT"
    endif 
```

## driverframework/L0_task/03_work/TASK_03_MAG_RTK/Kconfig
```kconfig
menuconfig WORK_TASK_MAG_TEST_6308_EN
    bool "ENABLE: WORK_TASK_MAG_TEST_6308_EN"
    default n
    help
        Enable MAG RTK test task using QMC6308 on I2C

    if WORK_TASK_MAG_TEST_6308_EN

        config WORK_TASK_MAG_TEST_6308_I2C_NAME
            string "I2C bus device name"
            default "hwi2c1"
            help
                The I2C bus device name used to access QMC6308

        config WORK_TASK_MAG_TEST_6308_I2C_ADDR
            hex "I2C device address"
            default 0x2C
            help
                7-bit I2C address of QMC6308

        config WORK_TASK_MAG_TEST_6308_ID_REG
            hex "ID register address"
            default 0x00
            help
                Register address to read device ID from

        config WORK_TASK_MAG_TEST_6308_ID_EXPECT
            hex "Expected ID register value"
            default 0x80
            help
                Expected value read from the ID register

        config WORK_TASK_MAG_TEST_6308_UART_NAME
            string "UART device name"
            default "uart1"
            help
                UART device to communicate test results

        config WORK_TASK_MAG_TEST_6308_UART_BAUD
            int "UART baudrate"
            default 115200
            help
                UART baudrate to use

    endif
```
