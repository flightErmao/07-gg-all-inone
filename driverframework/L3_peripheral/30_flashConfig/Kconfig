## driverframework/L3_peripheral/30_flashConfig/Kconfig
```kconfig
menuconfig BSP_USING_ON_CHIP_FLASH
    bool "Enable ON-CHIP FLASH CONFIG"
    default n
    if BSP_USING_ON_CHIP_FLASH
        config L3_PERIPHERAL_USING_ON_CHIP_FLASH_AUTOSTART_FALINIT
            bool "Enable ON-CHIP FLASH AUTOSTART FALINIT"
            default n
    endif
```

## driverframework/L3_peripheral/31_sdioConfig/Kconfig
```kconfig
menuconfig BSP_USING_SDIO
    bool "Enable 31 SDIO CONFIG"
    select RT_USING_SDIO
    select RT_USING_DFS
    default n
    if BSP_USING_SDIO
        config BSP_USING_SDIO1
            bool "Enable SDIO1"
            default n
        config BSP_USING_SDCARD
            bool "Enable SDCARD"                        
            select RT_USING_DFS_ELMFAT
            select RT_USING_PIN
            default n
        config AUTO_MOUNT_SD
            bool "Enable auto mount SD"
            select BSP_USING_SDCARD
            default n
    endif
        
```

## driverframework/L3_peripheral/I2C_REG/Kconfig
```kconfig
    menuconfig BSP_USING_I2C
        bool "Enable I2C BUS (hardware)"
        default n        
        select RT_USING_I2C
        if BSP_USING_I2C
            menuconfig BSP_USING_HARD_I2C1
                bool "Enable HARD I2C1"
                default y
                if BSP_USING_HARD_I2C1
                    config BSP_I2C1_SPEED
                        int "I2C1 Speed (Hz)"
                        default 400000
                        range 100000 1000000
                        help
                            I2C1 bus speed in Hz. Default is 400KHz (400000).
                        
                    config BSP_I2C1_TX_USING_DMA
                        bool "Enable HARD I2C1 TX DMA"
                        default n        
                    config BSP_I2C1_RX_USING_DMA
                        bool "Enable HARD I2C1 RX DMA"
                        default n
                endif            
                
            menuconfig BSP_USING_HARD_I2C2
                bool "Enable HARD I2C2"
                default n
                if BSP_USING_HARD_I2C2
                    config BSP_I2C2_SPEED
                        int "I2C2 Speed (Hz)"
                        default 400000
                        range 100000 1000000
                        help
                            I2C2 bus speed in Hz. Default is 400KHz (400000).
                        
                    config BSP_I2C2_TX_USING_DMA
                        bool "Enable HARD I2C2 TX DMA"
                        default n        
                    config BSP_I2C2_RX_USING_DMA
                        bool "Enable HARD I2C2 RX DMA"
                        default n
                endif
        endif
```

## driverframework/L3_peripheral/Kconfig
```kconfig
menu "L3_PERIPHERAL_CONFIG"
    source "$(PROJECT_ROOT)/driverframework/L3_peripheral/01_hseConfig/Kconfig"
    source "$(PROJECT_ROOT)/driverframework/L3_peripheral/02_nvicConfig/Kconfig"

    source "$(PROJECT_ROOT)/driverframework/L3_peripheral/10_gpioConfig/Kconfig"
    source "$(PROJECT_ROOT)/driverframework/L3_peripheral/11_uartConfig/Kconfig"
    source "$(PROJECT_ROOT)/driverframework/L3_peripheral/12_i2cConfig/Kconfig"
    source "$(PROJECT_ROOT)/driverframework/L3_peripheral/13_spiConfig/Kconfig"
    source "$(PROJECT_ROOT)/driverframework/L3_peripheral/14_usbConfig/Kconfig"
    
    source "$(PROJECT_ROOT)/driverframework/L3_peripheral/20_adcConfig/Kconfig"
    source "$(PROJECT_ROOT)/driverframework/L3_peripheral/21_pwmConfig/Kconfig"
    source "$(PROJECT_ROOT)/driverframework/L3_peripheral/22_timConfig/Kconfig"
    

endmenu
```

## driverframework/L4_mcu/Kconfig
```kconfig
menuconfig L4_MCU_CONFIG_EN
    bool "L4_MCU_TYPE_CONFIG"
    default y
    help
        Enable MCU configuration.

    if L4_MCU_CONFIG_EN
        choice TARGET_BOARD_TYPE
            prompt "Target Board Type"
            default TARGET_BOARD_FMUV2
            help
                Select the target board type.

            config TARGET_BOARD_FMUV2
                bool "FMUv2"
                help
                    FMUv2 target board for flight management unit applications

            config TARGET_BOARD_MINIFLY
                bool "MiniFly"
                help
                    MiniFly target board for small flight control applications

        endchoice

        choice MCU_TYPE
            prompt "MCU Type"
            default MCU_TYPE_STM32F427xx
            help
                Select the STM32F4 series MCU type.

            config MCU_TYPE_STM32F427xx
                bool "STM32F427xx"
                help
                    STM32F427xx MCU with 2MB Flash, 256KB RAM

            config MCU_TYPE_STM32F411CE
                bool "STM32F411CE"
                help
                    STM32F411CE MCU with 512KB Flash, 128KB RAM

        endchoice
    endif
```

## driverframework/L4_soc/Kconfig
```kconfig
menu "L4_SOC_CONFIG"

    config SOC_FAMILY_STM32
        bool "STM32 SoC Family"

    config SOC_FAMILY_AT32
        bool "AT32 SoC Family"

    menu "STM32 Series Selection"
        depends on SOC_FAMILY_STM32

        config SOC_SERIES_STM32F1
            bool "STM32F1 Series"

        config SOC_SERIES_STM32F2
            bool "STM32F2 Series"

        config SOC_SERIES_STM32F3
            bool "STM32F3 Series"

        config SOC_SERIES_STM32F4
            bool "STM32F4 Series"

            if SOC_SERIES_STM32F4
                config SOC_STM32F427II
                    bool "STM32F427II"
            endif

    endmenu

    menu "AT32 Series Selection"
        depends on SOC_FAMILY_AT32

    config SOC_SERIES_AT32F435
        bool "AT32F435 Series"

        if SOC_SERIES_AT32F435
            config SOC_AT32F435ZMT7
                bool "AT32F435ZMT7"
        endif


    config SOC_SERIES_AT32F437
        bool "AT32F437 Series"

    endmenu

endmenu
```

## target/01-stm32/01-stm32f411ce/Kconfig
```kconfig
mainmenu "RT-Thread Configuration"

# Define path variables (relative to current BSP directory)
BSP_DIR := .
PROJECT_ROOT := ../../..
RTT_DIR := $(PROJECT_ROOT)/kernel/rtthread
PKGS_DIR := $(PROJECT_ROOT)/tools/env_win/packages/packages
libraries_path_prefix := ../libraries
driverframework_path := $(PROJECT_ROOT)/driverframework

config SOC_STM32F411RE
    bool
    select SOC_SERIES_STM32F4
    select RT_USING_COMPONENTS_INIT
    select RT_USING_USER_MAIN
    default y

source "$(RTT_DIR)/Kconfig"
osource "$(PKGS_DIR)/Kconfig"
rsource "$(libraries_path_prefix)/Kconfig"
source "$(driverframework_path)/Kconfig"
```

## target/01-stm32/04-stm32h743/Kconfig
```kconfig
mainmenu "RT-Thread Configuration"

# Define path variables (relative to current BSP directory)
BSP_DIR := .
PROJECT_ROOT := ../../..
RTT_DIR := $(PROJECT_ROOT)/kernel/rtthread
PKGS_DIR := $(PROJECT_ROOT)/tools/env_win/packages/packages
libraries_path_prefix := $(RTT_DIR)/bsp/stm32/libraries
driverframework_path := $(PROJECT_ROOT)/driverframework

config SOC_STM32H743XI
    bool
    select SOC_SERIES_STM32H7
    select RT_USING_COMPONENTS_INIT
    select RT_USING_USER_MAIN
    default y

source "$(RTT_DIR)/Kconfig"
osource "$(PKGS_DIR)/Kconfig"
rsource "$(libraries_path_prefix)/Kconfig"
source "$(driverframework_path)/Kconfig"
```

## target/01_temp/05-stm32f407-8M/Kconfig
```kconfig
mainmenu "RT-Thread Configuration"

BSP_DIR := .
PROJECT_ROOT := ../../..
RTT_DIR := $(PROJECT_ROOT)/kernel/rtthread
PKGS_DIR := $(PROJECT_ROOT)/tools/env_win/packages/packages
libraries_path_prefix := $(RTT_DIR)/bsp/stm32/libraries
driverframework_path := $(PROJECT_ROOT)/driverframework

config SOC_STM32F407ZG
    bool
    select SOC_SERIES_STM32F4
    select RT_USING_COMPONENTS_INIT
    select RT_USING_USER_MAIN
    default y

config BOARD_STM32F407_ATK_EXPLORER
    bool
    default y

source "$(RTT_DIR)/Kconfig"
osource "$(PKGS_DIR)/Kconfig"
rsource "$(libraries_path_prefix)/Kconfig"
source "$(driverframework_path)/Kconfig"
```

## target/02_flyer_board/04_hollowCup/Kconfig
```kconfig
mainmenu "RT-Thread Configuration"

# Define path variables (relative to current BSP directory)
BSP_DIR := .
PROJECT_ROOT := ../../..
RTT_DIR := $(PROJECT_ROOT)/kernel/rtthread
PKGS_DIR := $(PROJECT_ROOT)/tools/env_win/packages/packages
libraries_path_prefix := $(RTT_DIR)/bsp/at32/libraries
driverframework_path := $(PROJECT_ROOT)/driverframework

config SOC_AT32F435ZMT7
    bool
    select SOC_SERIES_AT32F435
    select RT_USING_COMPONENTS_INIT
    select RT_USING_USER_MAIN
    default y

source "$(RTT_DIR)/Kconfig"
osource "$(PKGS_DIR)/Kconfig"
rsource "$(libraries_path_prefix)/Kconfig"
source "$(driverframework_path)/Kconfig"
# source "board/Kconfig"
```
