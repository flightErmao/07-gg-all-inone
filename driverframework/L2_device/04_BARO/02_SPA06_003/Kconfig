## driverframework/L3_peripheral/13_spiConfig/Kconfig
```kconfig
menuconfig BSP_USING_SPI
    bool "Enable 13 SPI CONFIG"
    default n
    select RT_USING_SPI
    if BSP_USING_SPI
        menuconfig BSP_USING_SPI1
            bool "Enable SPI1 BUS"
            default n
            depends on BSP_USING_SPI
            if BSP_USING_SPI1
                config BSP_SPI1_TX_USING_DMA
                    bool "Enable SPI1 TX DMA"
                    default n
                config BSP_SPI1_RX_USING_DMA
                    bool "Enable SPI1 RX DMA"
                    default n
            endif            
        menuconfig BSP_USING_SPI2
            bool "Enable SPI2 BUS"
            default n
            depends on BSP_USING_SPI
            if BSP_USING_SPI2
                config BSP_SPI2_TX_USING_DMA
                    bool "Enable SPI2 TX DMA"                    
                    default n
                config BSP_SPI2_RX_USING_DMA
                    bool "Enable SPI2 RX DMA"
                    default n                
            endif
    endif
```

## driverframework/L3_peripheral/14_usbConfig/Kconfig
```kconfig
menu "Enable 14 USB CONFIG"
        if SOC_FAMILY_AT32
                menuconfig BSP_USING_USBOTG
                        bool "Enable AT32 USB BUS"
                        default n
                        if BSP_USING_USBOTG
                                menuconfig BSP_USING_USBOTG1
                                        bool "Enable AT32 USB BUS1"
                                        default n
                                        if BSP_USING_USBOTG1
                                                config BSP_USING_DEVICE_USBOTG1
                                                        bool "Enable AT32 USB1 Deivce"
                                                        select RT_USING_USB_DEVICE
                                                        default n

                                                config BSP_USING_HOST_USBOTG1
                                                        bool "Enable AT32 USB1 Host"
                                                        select RT_USING_USB_HOST
                                                        default n
                                        endif

                                menuconfig BSP_USING_USBOTG2
                                        bool "Enable AT32 USB BUS2"
                                        default n
                                        if BSP_USING_USBOTG2
                                                config BSP_USING_DEVICE_USBOTG2
                                                        bool "Enable AT32 USB2 Deivce"
                                                        select RT_USING_USB_DEVICE
                                                        default n

                                                config BSP_USING_HOST_USBOTG2
                                                        bool "Enable AT32 USB2 Host"
                                                        select RT_USING_USB_HOST
                                                        default n
                                        endif
                        endif
        endif

        if !SOC_FAMILY_AT32
                menuconfig BSP_USING_USBD
                        bool "Enable STM32 USB CONFIG"
                        select RT_USING_USB_DEVICE
                        default n
        endif
endmenu
```

## driverframework/L3_peripheral/20_adcConfig/Kconfig
```kconfig
menuconfig BSP_USING_ADC
    bool "Enable 20 ADC CONFIG"
    default n
    select RT_USING_ADC
    if BSP_USING_ADC
        config BSP_USING_ADC1
            bool "Enable ADC1"
            default n
    endif
```

## driverframework/L3_peripheral/21_pwmConfig/Kconfig
```kconfig
menuconfig BSP_USING_PWM
    bool "Enable 21 PWM CONFIG"
    default n
    select RT_USING_PWM
    if BSP_USING_PWM
    menuconfig BSP_USING_PWM1
        bool "Enable timer1 output PWM"
        default n
        if BSP_USING_PWM1
            config BSP_USING_PWM1_CH1
                bool "Enable PWM1 channel1"
                default n

            config BSP_USING_PWM1_CH2
                bool "Enable PWM1 channel2"
                default n

            config BSP_USING_PWM1_CH3
                bool "Enable PWM1 channel3"
                default n
        
            config BSP_USING_PWM1_CH4
                bool "Enable PWM1 channel4"
                default n
        endif
    menuconfig BSP_USING_PWM2
        bool "Enable timer2 output PWM"
        default n
        if BSP_USING_PWM2
            config BSP_USING_PWM2_CH1
                bool "Enable PWM2 channel1"
                default n

            config BSP_USING_PWM2_CH3
                bool "Enable PWM2 channel3"
                default n

        endif

    menuconfig BSP_USING_PWM4
        bool "Enable timer4 output PWM"
        default n
        if BSP_USING_PWM4
            config BSP_USING_PWM4_CH1
                bool "Enable PWM4 channel1"
                default n

            config BSP_USING_PWM4_CH2
                bool "Enable PWM4 channel2"
                default n

        endif
    endif
```

## driverframework/L3_peripheral/22_timConfig/Kconfig
```kconfig
if SOC_FAMILY_AT32
    menuconfig BSP_USING_HWTIMER
        bool "Enable 22 Hardware Timer"
        default n
        select RT_USING_HWTIMER
        if BSP_USING_HWTIMER
            config BSP_USING_HWTMR10
                bool "Enable HWTMR10"
                default n

            config BSP_USING_HWTMR11
                bool "Enable HWTMR11"
                default n
        endif
endif

if SOC_FAMILY_STM32
    menuconfig BSP_USING_TIM
        bool "Enable 22 Hardware Timer"
        default n
        select RT_USING_HWTIMER
        if BSP_USING_TIM
            config BSP_USING_TIM10
                bool "Enable TIM10"
                default n

            config BSP_USING_TIM11
                bool "Enable TIM11"
                default n
        endif
endif
```
