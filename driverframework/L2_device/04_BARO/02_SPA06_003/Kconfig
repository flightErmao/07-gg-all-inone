## driverframework/L2_device/04_BARO/02_SPA06_003/Kconfig
```kconfig
if BSP_USING_SPA06_003
        menuconfig SENSOR_SPA06_003_NUM1
            bool "ENABLE: SENSOR_SPA06_003_NUM1"
            default n
            if SENSOR_SPA06_003_NUM1
                config SENSOR_SPA06_003_NUM1_I2C_NAME
                    string "SPA06_003_I2C_NUM1_NAME"
                    default "hwi2c1"
                config SENSOR_SPA06_003_NUM1_DEVICE_NAME
                    string "SPA06_003_device_num1_name"
                    default "a06_03_1"  
                config SENSOR_SPA06_003_NUM1_I2C_ADDR
                    hex "SPA06_003_I2C_NUM1_ADDR"
                    default 0x76
                config SENSOR_SPA06_003_NUM1_ID
                    int "SPA06_003_I2C_NUM1_ID"
                    default 0
            endif
        menuconfig SENSOR_SPA06_003_NUM2
            bool "ENABLE: SENSOR_SPA06_003_NUM2"
            default n
            if SENSOR_SPA06_003_NUM2
                config SENSOR_SPA06_003_NUM2_I2C_NAME
                    string "SPA06_003_I2C_NUM2_NAME"
                    default "hwi2c2"
                config SENSOR_SPA06_003_NUM2_DEVICE_NAME
                    string "SPA06_003_device_num2_name"
                    default "a06_03_2"               
                config SENSOR_SPA06_003_NUM2_I2C_ADDR
                    hex "SPA06_003_I2C_NUM2_ADDR"
                    default 0x76
                config SENSOR_SPA06_003_NUM2_ID
                    int "SPA06_003_I2C_NUM2_ID"
                    default 1
            endif
    endif
```

## driverframework/L2_device/04_BARO/04_DPS368/Kconfig
```kconfig
if BSP_USING_DPS368
        config SENSOR_NAME_DPS368
            string "BARO DPS368 NAME"
            default "dsp368"
        config SENSOR_I2C_NAME_DPS368
            string "BARO DPS368 I2C NAME"
            default "hwi2c1"
        config SENSOR_DPS368_I2C_ADDR
            hex "DPS368_I2C_ADDR"
            default 0x76
    endif
```

## driverframework/L2_device/04_BARO/Kconfig
```kconfig
menuconfig BSP_USING_BARO
    bool "04 BARO CONFIG"
    default n
    if BSP_USING_BARO
        choice BSP_BARO_TYPE
            prompt "Barometer Type Selection"
            default BSP_USING_SPL06_001
            
            config BSP_USING_SPL06_001
                bool "SPL06-001"
                help
                    Use SPL06-001 barometer sensor
                    
            config BSP_USING_SPA06_003
                bool "SPA06-003"
                help
                    Use SPA06-003 barometer sensor
                    
            config BSP_USING_SPL16_001
                bool "SPL16-001"
                help
                    Use SPL16-001 barometer sensor
                    
            config BSP_USING_DPS368
                bool "DPS368"
                help
                    Use DPS368 barometer sensor
        endchoice
        
        if BSP_USING_SPL06_001
            source "$(PROJECT_ROOT)/driverframework/L2_device/04_BARO/01_SPL06_001/Kconfig"
        endif
        
        if BSP_USING_SPA06_003
            source "$(PROJECT_ROOT)/driverframework/L2_device/04_BARO/02_SPA06_003/Kconfig"
        endif
        
        if BSP_USING_SPL16_001
            source "$(PROJECT_ROOT)/driverframework/L2_device/04_BARO/03_SPL16_001/Kconfig"
        endif
        
        if BSP_USING_DPS368
            source "$(PROJECT_ROOT)/driverframework/L2_device/04_BARO/04_DPS368/Kconfig"
        endif
    endif
```

## driverframework/L2_device/05_mag/01_qmc5883l/Kconfig
```kconfig
menuconfig BSP_USING_MAG_QMC5883L
    bool "Enable: MAG_QMC5883L"
    default n 
    if BSP_USING_MAG_QMC5883L
        config SENSOR_NAME_QMC5883L 
            string "MAG QMC5883L NAME" 
            default "QMC5883L" 
        
        config SENSOR_I2C_NAME_QMC5883L 
            string "MAG QMC5883L I2C NAME" 
            default "hwi2c2" 
        
        config SENSOR_QMC5883L_I2C_ADDR 
            int "QMC5883L_I2C_ADDR" 
            default 0x0D
    endif
```

## driverframework/L2_device/05_mag/02_qmc6308/Kconfig
```kconfig
menuconfig BSP_USING_MAG_QMC6308
    bool "Enable: MAG_QMC6308"
    default n
    if BSP_USING_MAG_QMC6308
        config SENSOR_NAME_QMC6308
            string "MAG QMC6308 NAME"
            default "qmc6308"
        config SENSOR_I2C_NAME_QMC6308
            string "MAG QMC6308 I2C NAME"
            default "hwi2c1"
        config SENSOR_QMC6308_I2C_ADDR
            hex "QMC6308_I2C_ADDR"
            default 0x2C
    endif
```

## driverframework/L2_device/05_mag/Kconfig
```kconfig
menu "05 MAG CONFIG"
            menu "01 QMC5883L CONFIG"
                source "$(PROJECT_ROOT)/driverframework/L2_device/05_mag/01_qmc5883l/Kconfig"
            endmenu
            
            menu "02 QMC6308 CONFIG"
                source "$(PROJECT_ROOT)/driverframework/L2_device/05_mag/02_qmc6308/Kconfig"
            endmenu
        
endmenu
```

## driverframework/L2_device/BARO/Kconfig
```kconfig
source "$(PROJECT_ROOT)/driverframework/L2_device/BARO/SPL16_001/Kconfig"
source "$(PROJECT_ROOT)/driverframework/L2_device/BARO/DPS3XX/Kconfig"
```

## driverframework/L2_device/IMU/Kconfig
```kconfig
source "$(PROJECT_ROOT)/driverframework/L2_device/IMU/ICM42688_130/Kconfig"
source "$(PROJECT_ROOT)/driverframework/L2_device/IMU/MPU6050_minifly/Kconfig"
```

## driverframework/L2_device/IMU/MPU6050_minifly/Kconfig
```kconfig
menuconfig BSP_USING_MPU6050_MINIFLY
    bool "ENANLE: IMU_MPU6050_MINIFLY"
    default n
    select BSP_USING_I2C
    if BSP_USING_MPU6050_MINIFLY
        config SENSOR_NAME_MPU6050_MINIFLY
            string "IMU MPU6050 MINIFLY NAME"
            default "mpu6050_minifly"
        config SENSOR_I2C_NAME_MPU6050_MINIFLY
            string "IMU MPU6050 MINIFLY I2C NAME"
            default "hwi2c1"
        config SENSOR_MPU6050_MINIFLY_I2C_ADDR
            int "MPU6050_MINIFLY_I2C_ADDR"
            default 0x69
    endif
    
    
```

## driverframework/L2_device/IMU/MPU6500_minifly/Kconfig
```kconfig
menuconfig BSP_USING_MPU6500_MINIFLY
    bool "ENANLE: IMU_MPU6500_MINIFLY"
    default n
    select BSP_USING_I2C
    if BSP_USING_MPU6500_MINIFLY
        config SENSOR_NAME_MPU6500_MINIFLY
            string "IMU MPU6500 MINIFLY NAME"
            default "mpu6500_minifly"
        config SENSOR_I2C_NAME_MPU6500_MINIFLY
            string "IMU MPU6500 MINIFLY I2C NAME"
            default "hwi2c1"
        config SENSOR_MPU6500_MINIFLY_I2C_ADDR
            hex "mpu6500_MINIFLY_I2C_ADDR"
            default 0x69
            range 0x00 0x7F
        config SENSOR_MPU6500_MINIFLY_DEBUGPIN_EN
            bool "ENABLE: DEBUG PIN"
            default n
            help
                ENABLE: DEBUG PIN                
    endif
    
    
```

## driverframework/L2_device/Kconfig
```kconfig
menu "L2_DEVICE_CONFIG"
    source "$(PROJECT_ROOT)/driverframework/L2_device/01_IMU/Kconfig"
    source "$(PROJECT_ROOT)/driverframework/L2_device/02_RC/Kconfig"
    source "$(PROJECT_ROOT)/driverframework/L2_device/03_MOTOR/Kconfig"
    source "$(PROJECT_ROOT)/driverframework/L2_device/04_BARO/Kconfig"
endmenu
```

## driverframework/L3_config/BOARD/Kconfig
```kconfig
menuconfig BOARD_CONFIG
    bool "Enable board configuration"
    default n
    help
        Enable board configuration.

if BOARD_CONFIG
    choice MCU_HSE_FREQ
        prompt "MCU HSE frequency"
        default MCU_HSE_8MHZ
        help
            Select the external high-speed oscillator (HSE) frequency.

        config MCU_HSE_25MHZ
            bool "25 MHz"

        config MCU_HSE_8MHZ
            bool "8 MHz"
    endchoice

    config HSE_VALUE
        int
        default 25000000 if MCU_HSE_25MHZ
        default 8000000 if MCU_HSE_8MHZ
        help
            Numeric value in Hz for the selected HSE frequency.
endif 
```

## driverframework/L3_config/USB_SHELL/Kconfig
```kconfig
menuconfig BSP_USING_USBD
        bool "Enable USB Device"
        select RT_USING_USB_DEVICE
        default n
```

## driverframework/L3_peripheral/01_hseConfig/Kconfig
```kconfig
menuconfig L3_PERIPHERAL_01_HSE_CONFIG_EN
    bool "ENABLE: 01 HSE CONFIG"
    default n
    help
        Enable HSE configuration.

if L3_PERIPHERAL_01_HSE_CONFIG_EN
    choice MCU_HSE_FREQ
        prompt "MCU HSE frequency"
        default MCU_HSE_8MHZ
        help
            Select the external high-speed oscillator (HSE) frequency.

        config MCU_HSE_25MHZ
            bool "25 MHz"

        config MCU_HSE_8MHZ
            bool "8 MHz"

        config MCU_HSE_24MHZ
            bool "24 MHz"

    endchoice

    config HSE_VALUE
        int
        default 25000000 if MCU_HSE_25MHZ
        default 8000000 if MCU_HSE_8MHZ
        default 24000000 if MCU_HSE_24MHZ
        help
            Numeric value in Hz for the selected HSE frequency.
endif
```

## driverframework/L3_peripheral/02_nvicConfig/Kconfig
```kconfig
menuconfig L3_PERIPHERAL_02_NVIC_CONFIG_EN
    bool "ENABLE: 02 NVIC CONFIG"
    default n
    help
        Enable NVIC interrupt priority grouping configuration for STM32 MCUs.

    if L3_PERIPHERAL_02_NVIC_CONFIG_EN
        config L3_PERIPHERAL_02_NVIC_STM32_PRIORITY_GROUP
            int "STM32 Priority Group (0-4)"
            range 0 4
            default 4
            help
                Set the interrupt priority grouping for STM32 MCUs.
                0: 0 bits for pre-emption priority, 4 bits for subpriority
                1: 1 bits for pre-emption priority, 3 bits for subpriority
                2: 2 bits for pre-emption priority, 2 bits for subpriority
                3: 3 bits for pre-emption priority, 1 bits for subpriority
                4: 4 bits for pre-emption priority, 0 bits for subpriority
    endif
```

## driverframework/L3_peripheral/03_dfuConfig/Kconfig
```kconfig
menuconfig L3_PERIPHERAL_03_DFU_CONFIG_EN
    bool "ENABLE: 03 DFU CONFIG"
    default n
    help
        Enable DFU configuration for STM32 MCUs.
```

## driverframework/L3_peripheral/10_gpioConfig/Kconfig
```kconfig
config BSP_USING_GPIO
    bool "Enable: 10 GPIO CONFIG"
    select RT_USING_PIN
    default y
```
