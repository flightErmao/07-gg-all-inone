## driverframework/L3_peripheral/11_uartConfig/Kconfig
```kconfig
menuconfig BSP_USING_UART
        bool "Enable: 11 UART CONFIG"
        default y
        select RT_USING_SERIAL
        if BSP_USING_UART
            config BSP_STM32_UART_V1_TX_TIMEOUT
                int "UART TX timeout"
                default 2000
                depends on RT_USING_SERIAL_V1

            menuconfig BSP_USING_UART1
                bool "Enable UART1"
                default y

                if BSP_USING_UART1
                    config BSP_UART1_RX_USING_DMA
                        bool "Enable UART1 RX DMA"
                        depends on BSP_USING_UART1 && RT_SERIAL_USING_DMA
                        default n

                    config BSP_UART1_TX_USING_DMA
                        bool "Enable UART1 TX DMA"
                        depends on BSP_USING_UART1 && RT_SERIAL_USING_DMA
                        default n

                    config BSP_UART1_RX_BUFSIZE
                        int "Set UART1 RX buffer size"
                        range 64 65535
                        depends on RT_USING_SERIAL_V2
                        default 256

                    config BSP_UART1_TX_BUFSIZE
                        int "Set UART1 TX buffer size"
                        range 0 65535
                        depends on RT_USING_SERIAL_V2
                        default 64

                    config BSP_UART1_DMA_PING_BUFSIZE
                        int "Set UART1 RX DMA ping-pong buffer size"
                        range 32 65535
                        depends on RT_USING_SERIAL_V2 && BSP_UART1_RX_USING_DMA
                        default 64    
                endif

            menuconfig BSP_USING_UART2
                bool "Enable UART2"
                default n

                if BSP_USING_UART2
                    config BSP_UART2_RX_USING_DMA
                        bool "Enable UART2 RX DMA"
                        depends on BSP_USING_UART2 && RT_SERIAL_USING_DMA
                        default n

                    config BSP_UART2_TX_USING_DMA
                        bool "Enable UART2 TX DMA"
                        depends on BSP_USING_UART2 && RT_SERIAL_USING_DMA
                        default n

                    config BSP_UART2_RX_BUFSIZE
                        int "Set UART2 RX buffer size"
                        range 64 65535
                        depends on RT_USING_SERIAL_V2
                        default 256

                    config BSP_UART2_TX_BUFSIZE
                        int "Set UART2 TX buffer size"
                        range 0 65535
                        depends on RT_USING_SERIAL_V2
                        default 64

                    config BSP_UART2_DMA_PING_BUFSIZE
                        int "Set UART2 RX DMA ping-pong buffer size"
                        range 32 65535
                        depends on RT_USING_SERIAL_V2 && BSP_UART2_RX_USING_DMA
                        default 64                        
                endif

                menuconfig BSP_USING_UART3
                    bool "Enable UART3"
                    default n

                    if BSP_USING_UART3
                        config BSP_UART3_RX_USING_DMA
                            bool "Enable UART3 RX DMA"
                            depends on BSP_USING_UART3 && RT_SERIAL_USING_DMA
                            default n

                        config BSP_UART3_TX_USING_DMA
                            bool "Enable UART3 TX DMA"
                            depends on BSP_USING_UART3 && RT_SERIAL_USING_DMA
                            default n

                        config BSP_UART3_RX_BUFSIZE
                            int "Set UART3 RX buffer size"
                            range 64 65535
                            depends on RT_USING_SERIAL_V2
                            default 256

                        config BSP_UART3_TX_BUFSIZE
                            int "Set UART3 TX buffer size"
                            range 0 65535
                            depends on RT_USING_SERIAL_V2
                            default 64

                        config BSP_UART3_DMA_PING_BUFSIZE
                            int "Set UART3 RX DMA ping-pong buffer size"
                            range 32 65535
                            depends on RT_USING_SERIAL_V2 && BSP_UART3_RX_USING_DMA
                            default 64                        
                    endif

                menuconfig BSP_USING_UART4
                    bool "Enable UART4"
                    default n

                    if BSP_USING_UART4
                        config BSP_UART4_RX_USING_DMA
                            bool "Enable UART4 RX DMA"
                            depends on BSP_USING_UART4 && RT_SERIAL_USING_DMA
                            default n

                        config BSP_UART4_TX_USING_DMA
                            bool "Enable UART4 TX DMA"
                            depends on BSP_USING_UART4 && RT_SERIAL_USING_DMA
                            default n

                        config BSP_UART4_RX_BUFSIZE
                            int "Set UART4 RX buffer size"
                            range 64 65535
                            depends on RT_USING_SERIAL_V2
                            default 256

                        config BSP_UART4_TX_BUFSIZE
                            int "Set UART4 TX buffer size"
                            range 0 65535
                            depends on RT_USING_SERIAL_V2
                            default 64

                        config BSP_UART4_DMA_PING_BUFSIZE
                            int "Set UART4 RX DMA ping-pong buffer size"
                            range 32 65535
                            depends on RT_USING_SERIAL_V2 && BSP_UART4_RX_USING_DMA
                            default 64                        
                    endif

                menuconfig BSP_USING_UART5
                    bool "Enable UART5"
                    default n

                    if BSP_USING_UART5
                        config BSP_UART5_RX_USING_DMA
                            bool "Enable UART5 RX DMA"
                            depends on BSP_USING_UART5 && RT_SERIAL_USING_DMA
                            default n

                        config BSP_UART5_TX_USING_DMA
                            bool "Enable UART5 TX DMA"
                            depends on BSP_USING_UART5 && RT_SERIAL_USING_DMA
                            default n

                        config BSP_UART5_RX_BUFSIZE
                            int "Set UART5 RX buffer size"
                            range 64 65535
                            depends on RT_USING_SERIAL_V2
                            default 256

                        config BSP_UART5_TX_BUFSIZE
                            int "Set UART5 TX buffer size"
                            range 0 65535
                            depends on RT_USING_SERIAL_V2
                            default 64

                        config BSP_UART5_DMA_PING_BUFSIZE
                            int "Set UART5 RX DMA ping-pong buffer size"
                            range 32 65535
                            depends on RT_USING_SERIAL_V2 && BSP_UART5_RX_USING_DMA
                            default 64                        
                    endif

                menuconfig BSP_USING_UART6
                    bool "Enable UART6"
                    default n

                    if BSP_USING_UART6
                        config BSP_UART6_RX_USING_DMA
                            bool "Enable UART6 RX DMA"
                            depends on BSP_USING_UART6 && RT_SERIAL_USING_DMA
                            default n

                        config BSP_UART6_TX_USING_DMA
                            bool "Enable UART6 TX DMA"
                            depends on BSP_USING_UART6 && RT_SERIAL_USING_DMA
                            default n

                        config BSP_UART6_RX_BUFSIZE
                            int "Set UART6 RX buffer size"
                            range 64 65535
                            depends on RT_USING_SERIAL_V2
                            default 256

                        config BSP_UART6_TX_BUFSIZE
                            int "Set UART6 TX buffer size"
                            range 0 65535
                            depends on RT_USING_SERIAL_V2
                            default 64

                        config BSP_UART6_DMA_PING_BUFSIZE
                            int "Set UART6 RX DMA ping-pong buffer size"
                            range 32 65535
                            depends on RT_USING_SERIAL_V2 && BSP_UART6_RX_USING_DMA
                            default 64                        
                    endif

                menuconfig BSP_USING_UART7
                    bool "Enable UART7"
                    default n

                    if BSP_USING_UART7
                        config BSP_UART7_RX_USING_DMA
                            bool "Enable UART7 RX DMA"
                            depends on BSP_USING_UART7 && RT_SERIAL_USING_DMA
                            default n

                        config BSP_UART7_TX_USING_DMA
                            bool "Enable UART7 TX DMA"
                            depends on BSP_USING_UART7 && RT_SERIAL_USING_DMA
                            default n

                        config BSP_UART7_RX_BUFSIZE
                            int "Set UART7 RX buffer size"
                            range 64 65535
                            depends on RT_USING_SERIAL_V2
                            default 256

                        config BSP_UART7_TX_BUFSIZE
                            int "Set UART7 TX buffer size"
                            range 0 65535
                            depends on RT_USING_SERIAL_V2
                            default 64

                        config BSP_UART7_DMA_PING_BUFSIZE
                            int "Set UART7 RX DMA ping-pong buffer size"
                            range 32 65535
                            depends on RT_USING_SERIAL_V2 && BSP_UART7_RX_USING_DMA
                            default 64                        
                    endif

                menuconfig BSP_USING_UART8
                    bool "Enable UART8"
                    default n

                    if BSP_USING_UART8
                        config BSP_UART8_RX_USING_DMA
                            bool "Enable UART8 RX DMA"
                            depends on BSP_USING_UART8 && RT_SERIAL_USING_DMA
                            default n

                        config BSP_UART8_TX_USING_DMA
                            bool "Enable UART8 TX DMA"
                            depends on BSP_USING_UART8 && RT_SERIAL_USING_DMA
                            default n

                        config BSP_UART8_RX_BUFSIZE
                            int "Set UART8 RX buffer size"
                            range 64 65535
                            depends on RT_USING_SERIAL_V2
                            default 256

                        config BSP_UART8_TX_BUFSIZE
                            int "Set UART8 TX buffer size"
                            range 0 65535
                            depends on RT_USING_SERIAL_V2
                            default 64

                        config BSP_UART8_DMA_PING_BUFSIZE
                            int "Set UART8 RX DMA ping-pong buffer size"
                            range 32 65535
                            depends on RT_USING_SERIAL_V2 && BSP_UART8_RX_USING_DMA
                            default 64                        
                    endif                
        endif
```

## driverframework/L3_peripheral/12_i2cConfig/Kconfig
```kconfig
    menuconfig BSP_USING_I2C
        bool "Enable 12 I2C CONFIG"
        default n        
        select RT_USING_I2C
        if BSP_USING_I2C
            choice BSP_I2C_TYPE
                prompt "I2C Type Selection"
                default BSP_USING_HARD_I2C
                
                config BSP_USING_HARD_I2C
                    bool "Hardware I2C"
                    help
                        Use hardware I2C controller
                        
                config BSP_USING_SOFT_I2C
                    bool "Software I2C"
                    help
                        Use software I2C (bit-banging)
            endchoice
            
            if BSP_USING_HARD_I2C
                menuconfig BSP_USING_HARD_I2C1
                    bool "Enable HARD I2C1"
                    default y
                    if BSP_USING_HARD_I2C1
                        config BSP_I2C1_SPEED
                            int "I2C1 Speed (Hz)"
                            default 400000
                            range 100000 1000000
                            help
                                I2C1 bus speed in Hz. Default is 400KHz (400000).
                            
                        config BSP_I2C1_TX_USING_DMA
                            bool "Enable HARD I2C1 TX DMA"
                            default n        
                        config BSP_I2C1_RX_USING_DMA
                            bool "Enable HARD I2C1 RX DMA"
                            default n
                    endif            
                    
                menuconfig BSP_USING_HARD_I2C2
                    bool "Enable HARD I2C2"
                    default n
                    if BSP_USING_HARD_I2C2
                        config BSP_I2C2_SPEED
                            int "I2C2 Speed (Hz)"
                            default 400000
                            range 100000 1000000
                            help
                                I2C2 bus speed in Hz. Default is 400KHz (400000).
                            
                        config BSP_I2C2_TX_USING_DMA
                            bool "Enable HARD I2C2 TX DMA"
                            default n        
                        config BSP_I2C2_RX_USING_DMA
                            bool "Enable HARD I2C2 RX DMA"
                            default n
                    endif
            endif
            
            if BSP_USING_SOFT_I2C
                menuconfig BSP_USING_I2C1
                    bool "Enable SOFT I2C1"
                    default y
                    if BSP_USING_I2C1
                        config BSP_I2C1_SCL_PIN
                            int "I2C1 SCL Pin"
                            default 24
                            help
                                I2C1 SCL pin number. Default is PB8 (24).
                                
                        config BSP_I2C1_SDA_PIN
                            int "I2C1 SDA Pin"
                            default 25
                            help
                                I2C1 SDA pin number. Default is PB9 (25).
                    endif
                    
                menuconfig BSP_USING_I2C2
                    bool "Enable SOFT I2C2"
                    default n
                    if BSP_USING_I2C2
                        config BSP_I2C2_SCL_PIN
                            int "I2C2 SCL Pin"
                            default 24
                            help
                                I2C2 SCL pin number. Default is PB8 (24).
                                
                        config BSP_I2C2_SDA_PIN
                            int "I2C2 SDA Pin"
                            default 25
                            help
                                I2C2 SDA pin number. Default is PB9 (25).
                    endif
            endif
        endif
```
