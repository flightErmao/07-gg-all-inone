## driverframework/L0_task/TASK_05_SENSOR_MINIFLY/Kconfig
```kconfig
menuconfig TASK_05_SENSOR_MINIFLY
    bool "ENABLE: TASK_05_SENSOR_MINIFLY"
    default n
    select BSP_USING_MPU6500_MINIFLY
    help
        Enable sensor test task that periodically calls sensor test interface.
    if TASK_05_SENSOR_MINIFLY
        config TASK_SENSOR_MINIFLY_IMU_NAME
            string "IMU device name for sensor_minifly task"
            default "mpu6500_minifly"
            help
                IMU device name used by sensor_minifly task. Default is the MPU6500 MINIFLY device name.

    endif
```

## driverframework/L0_task/TASK_1_LED_BLINK/Kconfig
```kconfig
menuconfig BSP_USING_TASK_1_LED_BLINK
    bool "ENABLE: TASK_1_LED_BLINK"
    default n
    help
        Enable LED blink task that periodically calls Simulink model interface.
        
        When enabled, the system creates an independent thread to run the LED blink task,
        with a timer triggering every 500ms to call the Simulink model's step function.
        
    if BSP_USING_TASK_1_LED_BLINK
        config TASK_1_LED_BLINK_PRIORITY
            int "LED Blink Task Priority"
            default 5
            range 1 10
            help
                Set the thread priority for LED blink task.
                Lower values indicate higher priority.

        config TASK_1_LED_BLINK_TIMER_INTERVAL
            int "LED Blink Timer Interval (ms)"
            default 500
            range 100 10000
            help
                Set the timer interval for LED blink task.
                Unit: milliseconds

        config TASK_1_LED_BLINK_DEBUG
            bool "Enable LED Blink Task Debug Info"
            default y
            help
                Enable debug output information for LED blink task.
                Includes task start, stop, timer trigger and other information.
    endif 
```

## driverframework/L0_task/TASK_2_GPS_TEST/Kconfig
```kconfig
menuconfig BSP_USING_TASK_2_GPS_TEST
    bool "ENABLE: TASK_2_GPS_TEST"
    default n
    help
        Enable GPS test task that periodically calls GPS test interface.
        
        When enabled, the system creates an independent thread to run the GPS test task,
        with a timer triggering every 1000ms to call the GPS test step function.
```

## driverframework/L1_1_mode/01_led_blink/Kconfig
```kconfig
menuconfig L1_MODULE_LED_BLINK
    bool "ENABLE: LED_BLINK"
    default n
    help
       open led blink module
```

## driverframework/L1_1_mode/Kconfig
```kconfig
menu "L1_1_MODE_CONFIG"
    source "$(PROJECT_ROOT)/driverframework/L1_1_mode/01_led_blink/Kconfig"
endmenu
```

## driverframework/L1_middleWare/01_module/01_floatConver/Kconfig
```kconfig
menuconfig L1_MIDDLEWARE_01_MODULE_01_FLOATCONVER_EN
    bool "ENABLE: L1_MIDDLEWARE_01_MODULE_01_FLOATCONVER_EN"    
    default y
    help
        Enable float conversion module that provides various float conversion functions.
```

## driverframework/L1_middleWare/01_module/02_maths/Kconfig
```kconfig
menuconfig L1_MIDDLEWARE_01_MODULE_02_MATHS_EN
    bool "ENABLE: L1_MIDDLEWARE_01_MODULE_02_MATHS_EN"
    default n
    help
        Enable maths module that provides various mathematical functions.
```

## driverframework/L1_middleWare/01_module/03_debugPin/Kconfig
```kconfig
menuconfig L1_MIDDLEWARE_01_MODULE_03_DEBUGPIN_EN
    bool "ENABLE: L1_MIDDLEWARE_01_MODULE_03_DEBUGPIN_EN"
    default n
    help
        Enable debug pin module that provides 4 configurable debug pins for debugging purposes.
        
        This module allows configuration of 4 debug pins (DEBUG0, DEBUG1, DEBUG2, DEBUG3) with individual
        pin selection and provides high/low/toggle control functions.
        
    if L1_MIDDLEWARE_01_MODULE_03_DEBUGPIN_EN
        config L1_MIDDLEWARE_01_MODULE_03_DEBUGPIN_0_EN
            bool "Enable DEBUG0 Debug Pin"
            default y
            help
                Enable or disable DEBUG0 debug pin individually.
                When enabled, DEBUG0 pin will be configured and available for debugging.

        config L1_MIDDLEWARE_01_MODULE_03_DEBUGPIN_0_PIN
            string "DEBUG0 Debug Pin (e.g. PC15, PA0, PB1)"
            default "PC15"
            depends on L1_MIDDLEWARE_01_MODULE_03_DEBUGPIN_0_EN
            help
                Enter the DEBUG0 debug GPIO pin in format like "PA0", "PB1", "PC15".
                The tool will parse it and map to the correct pin number at runtime.

        config L1_MIDDLEWARE_01_MODULE_03_DEBUGPIN_1_EN
            bool "Enable DEBUG1 Debug Pin"
            default y
            help
                Enable or disable DEBUG1 debug pin individually.
                When enabled, DEBUG1 pin will be configured and available for debugging.

        config L1_MIDDLEWARE_01_MODULE_03_DEBUGPIN_1_PIN
            string "DEBUG1 Debug Pin (e.g. PB0, PA1, PC14)"
            default "PB0"
            depends on L1_MIDDLEWARE_01_MODULE_03_DEBUGPIN_1_EN
            help
                Enter the DEBUG1 debug GPIO pin in format like "PA1", "PB0", "PC14".
                The tool will parse it and map to the correct pin number at runtime.

        config L1_MIDDLEWARE_01_MODULE_03_DEBUGPIN_2_EN
            bool "Enable DEBUG2 Debug Pin"
            default y
            help
                Enable or disable DEBUG2 debug pin individually.
                When enabled, DEBUG2 pin will be configured and available for debugging.

        config L1_MIDDLEWARE_01_MODULE_03_DEBUGPIN_2_PIN
            string "DEBUG2 Debug Pin (e.g. PB1, PA2, PC13)"
            default "PB1"
            depends on L1_MIDDLEWARE_01_MODULE_03_DEBUGPIN_2_EN
            help
                Enter the DEBUG2 debug GPIO pin in format like "PA2", "PB1", "PC13".
                The tool will parse it and map to the correct pin number at runtime.

        config L1_MIDDLEWARE_01_MODULE_03_DEBUGPIN_3_EN
            bool "Enable DEBUG3 Debug Pin"
            default y
            help
                Enable or disable DEBUG3 debug pin individually.
                When enabled, DEBUG3 pin will be configured and available for debugging.

        config L1_MIDDLEWARE_01_MODULE_03_DEBUGPIN_3_PIN
            string "DEBUG3 Debug Pin (e.g. PA8, PB2, PC12)"
            default "PA8"
            depends on L1_MIDDLEWARE_01_MODULE_03_DEBUGPIN_3_EN
            help
                Enter the DEBUG3 debug GPIO pin in format like "PA8", "PB2", "PC12".
                The tool will parse it and map to the correct pin number at runtime.

        config L1_MIDDLEWARE_01_MODULE_03_DEBUGPIN_TESTSELF_EN
            bool "Enable Debug Pin Self Test Command"
            default n
            help
                Enable debug pin self test command that will toggle each enabled debug pin
                in sequence with 1 second intervals for testing purposes.

    endif 
```

## driverframework/L1_middleWare/01_module/04_pid_minifly/Kconfig
```kconfig
menuconfig L1_MIDDLEWARE_01_MODULE_04_PID_MINIFLY_EN
    bool "ENABLE: L1_MIDDLEWARE_01_MODULE_04_PID_MINIFLY_EN"    
    default n
    help
        Enable pid minifly module that provides various pid minifly functions.
```

## driverframework/L1_middleWare/01_module/05_filter/Kconfig
```kconfig
menuconfig L1_MIDDLEWARE_01_MODULE_05_FILTER_RPM_EN
    bool "ENABLE: L1_MIDDLEWARE_01_MODULE_05_FILTER_RPM_EN"
    default n
    depends on L1_MIDDLEWARE_01_MODULE_02_MATHS_EN
    depends on PROJECT_MINIFLY_TASK_DSHOT_EN
    help
        Enable filter module.
    
```

## driverframework/L1_middleWare/01_module/06_hardTimestamp/Kconfig
```kconfig
menuconfig L1_MIDDLEWARE_01_MODULE_06_HARDTIMESTAMP_EN
    bool "ENABLE: L1_MIDDLEWARE_01_MODULE_06_HARDTIMESTAMP_EN"
    default n
    help
        Enable hardware timestamp module that provides microsecond-level timestamp functionality.
        When enabled:
        - Automatically initializes hardware SysTick for precise timing
        - Uses SysTick registers (SysTick->VAL, SysTick->LOAD) for microsecond precision
        - Provides systime_now_us() for high-resolution timestamp
        - Supports both STM32 and AT32 MCUs
        
        When disabled:
        - Falls back to rt_tick_get() conversion for basic timing
        - No hardware initialization required
```

## driverframework/L1_middleWare/02_mode/01_led_blink/Kconfig
```kconfig
menuconfig L1_MIDDLEWARE_02_MODE_01_LED_BLINK_EN
    bool "ENABLE: L1_MIDDLEWARE_02_MODE_01_LED_BLINK_EN"
    default n
    help
       open led blink module
```

## driverframework/L1_middleWare/Kconfig
```kconfig
menu "L1_MIDDLEWARE_CONFIG"

    source "$(PROJECT_ROOT)/driverframework/L1_middleWare/01_module/01_floatConver/Kconfig"
    source "$(PROJECT_ROOT)/driverframework/L1_middleWare/01_module/02_maths/Kconfig"
    source "$(PROJECT_ROOT)/driverframework/L1_middleWare/01_module/03_debugPin/Kconfig"
    source "$(PROJECT_ROOT)/driverframework/L1_middleWare/01_module/04_pid_minifly/Kconfig"
    source "$(PROJECT_ROOT)/driverframework/L1_middleWare/02_mode/01_led_blink/Kconfig"
    # source "$(PROJECT_ROOT)/driverframework/L1_middleWare/03_package/uMCN-latest/Kconfig"
endmenu
```

## driverframework/L2_device/01_IMU/01_ICM42688_130/Kconfig
```kconfig
config BSP_USING_ICM42688
    bool "Enable ICM42688 IMU Sensor"
    default n
    help
        Enable ICM42688 IMU sensor support
        
    if BSP_USING_ICM42688
        # Add specific configuration options for ICM42688 here
        # Such as I2C address, debug pins, etc.
    endif
```

## driverframework/L2_device/01_IMU/03_MPU6000_FMUV2/Kconfig
```kconfig
config BSP_USING_MPU6000
    bool "Enable MPU6000 IMU Sensor"
    default n
    select BSP_USING_SPI
    help
        Enable MPU6000 IMU sensor support
        
    if BSP_USING_MPU6000
        config SENSOR_NAME_MPU6000
            string "IMU MPU6000 NAME FOR TASK FIND"
            default "mpu6000"
        config SENSOR_MPU6000_ACC_RANGE_G
            int "IMU MPU6000 ACC FULL-SCALE (g)"
            default 8
            range 2 16
            help
                Accelerometer full-scale range in g. Typical values: 2/4/8/16.
        config SENSOR_MPU6000_GYRO_RANGE_DPS
            int "IMU MPU6000 GYRO FULL-SCALE (dps)"
            default 2000
            range 250 2000
            help
                Gyroscope full-scale range in dps. Typical values: 250/500/1000/2000.
        config SENSOR_SPI_NAME_MPU6000
            string "IMU MPU6000 SPI BUS NAME"
            default "spi1"
        config SENSOR_SPI_SLAVE_NAME_MPU6000
            string "IMU MPU6000 SPI SLAVE NAME"
            default "spi10"
        config SENSOR_MPU6000_SPI_CS_PIN_NAME
            string "IMU MPU6000 SPI CS PIN NAME (e.g. PC2)"
            default "PC2"
        config SENSOR_MPU6000_SPI_MAX_HZ
            int "IMU MPU6000 SPI MAX CLOCK (Hz)"
            default 3000000
            range 100000 20000000
        config SENSOR_MPU6000_DEBUGPIN_EN
            bool "ENABLE: DEBUG PIN"
            default n
            help
                ENABLE: DEBUG PIN
    endif
```

## driverframework/L2_device/01_IMU/04_BMI270/Kconfig
```kconfig
config BSP_USING_BMI270
    bool "Enable BMI270 IMU Sensor"
    default n
    select BSP_USING_SPI
    help
        Enable BMI270 IMU sensor support
        
    if BSP_USING_BMI270
        config SENSOR_NAME_BMI270
            string "IMU BMI270 NAME FOR TASK FIND"
            default "bmi270"
            
        config SENSOR_SPI_NAME_BMI270
            string "IMU BMI270 SPI NAME"
            default "spi1"

        config SENSOR_SPI_SLAVE_NAME_BMI270
            string "IMU BMI270 SPI SLAVE NAME"
            default "spi10"

        config SENSOR_BMI270_SPI_MAX_HZ
            int "IMU BMI270 SPI MAX CLOCK (Hz)"
            default 10000000
            range 100000 20000000

        config SENSOR_BMI270_SPI_CS_PIN
            string "IMU BMI270 SPI CS PIN"
            default "PA4"

        config SENSOR_BMI270_DEBUGPIN_EN
            bool "ENABLE: DEBUG PIN"
            default n
            help
                ENABLE: DEBUG PIN
    endif
```

## driverframework/L2_device/02_RC/02_crsf/Kconfig
```kconfig
config RC_USING_CRSF
    bool "Enable CRSF receiver"
    default n
    help
        Enable Team BlackSheep CRSF receiver (420000 8N1).

    if RC_USING_CRSF

        config RC_CRSF_UART_NAME
            string "CRSF UART device name"
            default "uart2"
            help
                The UART device name used for CRSF (e.g. uart1/uart2).

        config RC_CRSF_BAUDRATE
            int "CRSF baud rate"
            default 420000
            help
                CRSF uses 420000 baud, 8N1.

        config RC_CRSF_AUTO_START
            bool "Auto start CRSF thread"
            default y
            help
                When enabled, use INIT_COMPONENT_EXPORT to auto start CRSF init/thread like SBUS.

        config RC_CRSF_DEBUGPIN_EN
            bool "ENABLE: RC_CRSF_DEBUGPIN_EN"
            default n
            help
                Enable debug pin toggling inside CRSF RX path.

    endif
```

## driverframework/L2_device/02_RC/Kconfig
```kconfig
menu "02 RC CONFIG"    
    menu "01 SBUS CONFIG"
        source "$(PROJECT_ROOT)/driverframework/L2_device/02_RC/01_SBUS/Kconfig"
    endmenu
        
    menu "02 CRSF CONFIG"
        source "$(PROJECT_ROOT)/driverframework/L2_device/02_RC/02_CRSF/Kconfig"
    endmenu
endmenu
```

## driverframework/L2_device/03_MOTOR/01_pwm/Kconfig
```kconfig
config L2_DEVICE_03_MOTOR_01_PWM_EN
    bool "ENABLE: MOTOR 01 PWM"
    default n
    if L2_DEVICE_03_MOTOR_01_PWM_EN
        config L2_DEVICE_03_MOTOR_01_DEBUGPIN_EN
            bool "ENABLE: DEBUG PIN"
            default n
            help
                ENABLE: DEBUG PIN                
    endif
    
    
```

## driverframework/L2_device/03_MOTOR/01_pwm_no_hal/Kconfig
```kconfig
config L2_DEVICE_03_MOTOR_01_PWM_EN
    bool "ENABLE: MOTOR 01 PWM"
    default n
    if L2_DEVICE_03_MOTOR_01_PWM_EN
        config L2_DEVICE_03_MOTOR_01_DEBUGPIN_EN
            bool "ENABLE: DEBUG PIN"
            default n
            help
                ENABLE: DEBUG PIN
                
        config L2_DEVICE_03_MOTOR_01_MSH_CMD_EN
            bool "ENABLE: MSH COMMANDS"
            default n
            help
                ENABLE: Export motor test commands to MSH shell
                This will add motor_test and motor_safe_test commands
                for debugging and testing motor functionality
    endif
    
    
```
