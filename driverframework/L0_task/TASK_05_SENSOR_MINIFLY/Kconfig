## driverframework/L2_device/03_MOTOR/02_dshot/Kconfig
```kconfig
config L2_DEVICE_03_MOTOR_02_DSHOT_EN
    bool "ENABLE: MOTOR 02 DSHOT"
    default n
    help
        Enable DShot motor driver support

if L2_DEVICE_03_MOTOR_02_DSHOT_EN

    config DSHOT_DEVICE_NAME
        string "DShot Device Name"
        default "dshot"
        help
            Name for the DShot device

    config DSHOT_PROTOCOL_TYPE
        string "DShot Protocol Type"
        default "dshot_600"
        help
            Select DShot protocol type
            Options: "dshot_150", "dshot_300", "dshot_600"

    config DSHOT_MOTOR_NUMS
        int "Number of DShot motors"
        range 1 8
        default 4
        help
            Number of DShot motors to control

    config DSHOT_GPIO_PORT
        string "DShot GPIO Port"
        default "GPIOB"
        help
            GPIO Port for DShot signals
            Options: GPIOA, GPIOB, GPIOC

    config DSHOT_GPIO_PIN_MOTOR1
        int "DShot Motor 1 GPIO Pin"
        range 0 15
        default 6
        help
            GPIO pin number for Motor 1

    config DSHOT_GPIO_PIN_MOTOR2
        int "DShot Motor 2 GPIO Pin"
        range 0 15
        default 7
        help
            GPIO pin number for Motor 2

    config DSHOT_GPIO_PIN_MOTOR3
        int "DShot Motor 3 GPIO Pin"
        range 0 15
        default 8
        help
            GPIO pin number for Motor 3

    config DSHOT_GPIO_PIN_MOTOR4
        int "DShot Motor 4 GPIO Pin"
        range 0 15
        default 9
        help
            GPIO pin number for Motor 4

    config DSHOT_TIMER_SELECT
        int "DShot Timer"
        range 1 11
        default 4
        help
            Timer for DShot signal generation
            1: TMR1, 2: TMR2, 3: TMR3, 4: TMR4, etc.


    config DSHOT_BI_DIRECTIONAL
        bool "Enable Bi-directional DShot"
        default y
        help
            Enable bi-directional DShot communication

    config DSHOT_PACKAGE_STATISTICS
        bool "Enable DShot Package Statistics"
        default n
        help
            Enable DShot package statistics

    config DSHOT_DEBUGPIN_EN
        bool "ENABLE: DEBUG PIN"
        default n
        help
            ENABLE: DEBUG PIN

    config DSHOT_CMD_MOTOR_EN
        bool "Enable DShot Motor Command Interface"
        default n
        help
            Enable DShot motor command interface for testing and control
            This adds 'motor' command to MSH shell

endif
    
```

## driverframework/L2_device/03_MOTOR/03_pwm/Kconfig
```kconfig
config L2_DEVICE_03_MOTOR_03_PWM_EN
    bool "Enable PWM motor driver"
    default n
    help
        Enable PWM motor driver support for actuator control.

    if L2_DEVICE_03_MOTOR_03_PWM_EN

        config L2_DEVICE_03_MOTOR_03_PWM_DEVICE_NAME
            string "PWM device name"
            default "pwm1"
            help
                PWM device name used for motor control.
                Available options: pwm1, pwm2, pwm3, etc.

        config L2_DEVICE_03_MOTOR_03_PWM_PHYSICAL_CHANNELS
            string "PWM physical channels selection"
            default "1234"
            help
                Select 4 physical PWM channels from available channels (1-16).
                Format: 4 consecutive characters, each representing a channel number.
                Examples: "1234" (channels 1,2,3,4), "5678" (channels 5,6,7,8), etc.
                Note: Currently supports single-digit channels (1-9).
                This selects which hardware PWM channels are used for motors.

        config L2_DEVICE_03_MOTOR_03_PWM_CHANNEL_REMAP
            string "Motor channel remap sequence"
            default "1234"
            help
                Motor channel remap sequence. Default is "1234" (no remap).
                Examples: "2134", "4321", "1324", etc.
                This maps logical motor IDs (1-4) to physical PWM channels.

        config L2_DEVICE_03_MOTOR_03_PWM_FREQUENCY
            int "PWM frequency (Hz)"
            default 500
            help
                PWM frequency in Hz for motor control.                

        config L2_DEVICE_03_MOTOR_03_PWM_CMD_EN
            bool "Enable PWM motor command interface"
            default n
            help
                Enable MSH command interface for PWM motor control.

        config L2_DEVICE_03_MOTOR_03_PWM_DEBUGPIN_EN
            bool "Enable PWM debug pin output"
            default n
            help
                Enable debug pin output for PWM motor control.

    endif
```

## driverframework/L2_device/03_MOTOR/Kconfig
```kconfig
menu "03 MOTOR CONFIG"
            menu "01 PWM CONFIG(Hollow slab)"
                source "$(PROJECT_ROOT)/driverframework/L2_device/03_MOTOR/01_pwm_no_hal/Kconfig"
            endmenu
            
            menu "02 DSHOT CONFIG"
                source "$(PROJECT_ROOT)/driverframework/L2_device/03_MOTOR/02_dshot/Kconfig"
            endmenu

            menu "03 PWM CONFIG"
                source "$(PROJECT_ROOT)/driverframework/L2_device/03_MOTOR/03_pwm/Kconfig"
            endmenu
endmenu
```

## driverframework/L2_device/04_BARO/01_SPL06_001/Kconfig
```kconfig
if BSP_USING_SPL06_001
    config SENSOR_SPL06_001_I2C_NAME
        string "SPL06_001 I2C bus name"
        default "i2c1"

    config SENSOR_SPL06_001_DEVICE_NAME
        string "SPL06_001 device name"
        default "spl06_001"

    config SENSOR_SPL06_001_I2C_ADDR
        hex "SPL06_001 I2C address (0x76 or 0x77)"
        default 0x77
        
    choice
        prompt "SPL06_001 pressure measurement rate (MR_P)"
        default SENSOR_SPL06_001_MR_PRESS_32
        config SENSOR_SPL06_001_MR_PRESS_1
            bool "1 Hz"
        config SENSOR_SPL06_001_MR_PRESS_2
            bool "2 Hz"
        config SENSOR_SPL06_001_MR_PRESS_4
            bool "4 Hz"
        config SENSOR_SPL06_001_MR_PRESS_8
            bool "8 Hz"
        config SENSOR_SPL06_001_MR_PRESS_16
            bool "16 Hz"
        config SENSOR_SPL06_001_MR_PRESS_32
            bool "32 Hz"
        config SENSOR_SPL06_001_MR_PRESS_64
            bool "64 Hz"
        config SENSOR_SPL06_001_MR_PRESS_128
            bool "128 Hz"
    endchoice

    config SENSOR_SPL06_001_MR_PRESS
        int
        default 0 if SENSOR_SPL06_001_MR_PRESS_1
        default 1 if SENSOR_SPL06_001_MR_PRESS_2
        default 2 if SENSOR_SPL06_001_MR_PRESS_4
        default 3 if SENSOR_SPL06_001_MR_PRESS_8
        default 4 if SENSOR_SPL06_001_MR_PRESS_16
        default 5 if SENSOR_SPL06_001_MR_PRESS_32
        default 6 if SENSOR_SPL06_001_MR_PRESS_64
        default 7 if SENSOR_SPL06_001_MR_PRESS_128

    choice
        prompt "SPL06_001 pressure oversampling (OSR_P)"
        default SENSOR_SPL06_001_OSR_PRESS_8X
        config SENSOR_SPL06_001_OSR_PRESS_1X
            bool "1X"
        config SENSOR_SPL06_001_OSR_PRESS_2X
            bool "2X"
        config SENSOR_SPL06_001_OSR_PRESS_4X
            bool "4X"
        config SENSOR_SPL06_001_OSR_PRESS_8X
            bool "8X"
        config SENSOR_SPL06_001_OSR_PRESS_16X
            bool "16X"
        config SENSOR_SPL06_001_OSR_PRESS_32X
            bool "32X"
        config SENSOR_SPL06_001_OSR_PRESS_64X
            bool "64X"
        config SENSOR_SPL06_001_OSR_PRESS_128X
            bool "128X"
    endchoice

    config SENSOR_SPL06_001_OSR_PRESS
        int
        default 0 if SENSOR_SPL06_001_OSR_PRESS_1X
        default 1 if SENSOR_SPL06_001_OSR_PRESS_2X
        default 2 if SENSOR_SPL06_001_OSR_PRESS_4X
        default 3 if SENSOR_SPL06_001_OSR_PRESS_8X
        default 4 if SENSOR_SPL06_001_OSR_PRESS_16X
        default 5 if SENSOR_SPL06_001_OSR_PRESS_32X
        default 6 if SENSOR_SPL06_001_OSR_PRESS_64X
        default 7 if SENSOR_SPL06_001_OSR_PRESS_128X

    choice
        prompt "SPL06_001 temperature measurement rate (MR_T)"
        default SENSOR_SPL06_001_MR_TEMP_32
        config SENSOR_SPL06_001_MR_TEMP_1
            bool "1 Hz"
        config SENSOR_SPL06_001_MR_TEMP_2
            bool "2 Hz"
        config SENSOR_SPL06_001_MR_TEMP_4
            bool "4 Hz"
        config SENSOR_SPL06_001_MR_TEMP_8
            bool "8 Hz"
        config SENSOR_SPL06_001_MR_TEMP_16
            bool "16 Hz"
        config SENSOR_SPL06_001_MR_TEMP_32
            bool "32 Hz"
        config SENSOR_SPL06_001_MR_TEMP_64
            bool "64 Hz"
        config SENSOR_SPL06_001_MR_TEMP_128
            bool "128 Hz"
    endchoice

    config SENSOR_SPL06_001_MR_TEMP
        int
        default 0 if SENSOR_SPL06_001_MR_TEMP_1
        default 1 if SENSOR_SPL06_001_MR_TEMP_2
        default 2 if SENSOR_SPL06_001_MR_TEMP_4
        default 3 if SENSOR_SPL06_001_MR_TEMP_8
        default 4 if SENSOR_SPL06_001_MR_TEMP_16
        default 5 if SENSOR_SPL06_001_MR_TEMP_32
        default 6 if SENSOR_SPL06_001_MR_TEMP_64
        default 7 if SENSOR_SPL06_001_MR_TEMP_128

    choice
        prompt "SPL06_001 temperature oversampling (OSR_T)"
        default SENSOR_SPL06_001_OSR_TEMP_8X
        config SENSOR_SPL06_001_OSR_TEMP_1X
            bool "1X"
        config SENSOR_SPL06_001_OSR_TEMP_2X
            bool "2X"
        config SENSOR_SPL06_001_OSR_TEMP_4X
            bool "4X"
        config SENSOR_SPL06_001_OSR_TEMP_8X
            bool "8X"
        config SENSOR_SPL06_001_OSR_TEMP_16X
            bool "16X"
        config SENSOR_SPL06_001_OSR_TEMP_32X
            bool "32X"
        config SENSOR_SPL06_001_OSR_TEMP_64X
            bool "64X"
        config SENSOR_SPL06_001_OSR_TEMP_128X
            bool "128X"
    endchoice

    config SENSOR_SPL06_001_OSR_TEMP
        int
        default 0 if SENSOR_SPL06_001_OSR_TEMP_1X
        default 1 if SENSOR_SPL06_001_OSR_TEMP_2X
        default 2 if SENSOR_SPL06_001_OSR_TEMP_4X
        default 3 if SENSOR_SPL06_001_OSR_TEMP_8X
        default 4 if SENSOR_SPL06_001_OSR_TEMP_16X
        default 5 if SENSOR_SPL06_001_OSR_TEMP_32X
        default 6 if SENSOR_SPL06_001_OSR_TEMP_64X
        default 7 if SENSOR_SPL06_001_OSR_TEMP_128X
endif
```

## driverframework/L2_device/04_BARO/01_SPL16_001/Kconfig
```kconfig
menuconfig BSP_USING_SPL16_001
    bool "ENANLE: BARO 01 SPL16_001"
    default n
    select RT_USING_I2C
    if BSP_USING_SPL16_001
        menuconfig SPL16001_ID1
            bool "Enable: SPL16001_ID1"
            default n
            if SPL16001_ID1
                config SPL16001_DEVICE_NAME_ID1
                    string "Device Name"
                    default "spl16001_id1"
                    help
                        Device Name for ID1
                config SPL16001_I2C_NAME_ID1
                    string "I2C Device"
                    default "hwi2c1"
                    help
                        I2C Device name for ID1
                config SPL16001_I2C_ADDRESS_ID1
                    hex "I2C Address"
                    default 0x77
                    help
                        I2C Address for ID1
            endif
    endif
```
