## driverframework/L0_task/04_project/05_bf/imu/Kconfig
```kconfig
menuconfig PROJECT_BF_BMI270_EN
    bool "Enable BMI270 Betaflight-style IMU Sensor"
    default n
    select PROJECT_BF_COMMON_EN
    select BSP_USING_SPI
    help
        Enable BMI270 IMU driver for Betaflight-style project (no FIFO, DRDY interrupt + register read).

    if PROJECT_BF_BMI270_EN

        config SENSOR_SPI_NAME_BMI270_BF
            string "BMI270 BF SPI bus name"
            default "spi1"

        config SENSOR_SPI_SLAVE_NAME_BMI270_BF
            string "BMI270 BF SPI device name"
            default "spi10"

        config SENSOR_BMI270_BF_SPI_MAX_HZ
            int "BMI270 BF SPI max frequency (Hz)"
            default 10000000
            range 100000 20000000

        config SENSOR_BMI270_BF_SPI_CS_PIN
            string "BMI270 BF SPI CS pin"
            default "PA4"

        config SENSOR_BMI270_BF_INT_PIN
            string "BMI270 BF interrupt pin"
            default "PA15"

        choice
            prompt "BMI270 BF output data rate"
            default SENSOR_BMI270_BF_ODR_3200HZ
            help
                Select the IMU output data rate (ODR) for both accelerometer and gyro.
                Higher ODR improves bandwidth but increases CPU load.

        config SENSOR_BMI270_BF_ODR_800HZ
            bool "800 Hz"

        config SENSOR_BMI270_BF_ODR_1600HZ
            bool "1600 Hz"

        config SENSOR_BMI270_BF_ODR_3200HZ
            bool "3200 Hz"

        endchoice

        choice
            prompt "BMI270 BF trigger mode"
            default SENSOR_BMI270_BF_TRIGGER_INTERRUPT
            help
                Select how to trigger IMU data reading:
                - Interrupt: Use hardware interrupt (DRDY pin) for accurate timing
                - Hardware timer: Use hardware timer for periodic triggering (based on ODR)

        config SENSOR_BMI270_BF_TRIGGER_INTERRUPT
            bool "Hardware interrupt (DRDY pin)"

        config SENSOR_BMI270_BF_TRIGGER_TIMER
            bool "Hardware timer"
            depends on RT_USING_HWTIMER
            help
                Use hardware timer to trigger IMU data reading at configured ODR rate.
                Timer frequency will be automatically set based on selected ODR.

        endchoice

        config SENSOR_BMI270_BF_HWTIMER_DEV_NAME
            string "BMI270 BF hardware timer device name"
            default "timer1"
            depends on SENSOR_BMI270_BF_TRIGGER_TIMER
            help
                Hardware timer device name to use for triggering IMU data reading.
                Examples: "timer1", "timer2", "timer3", etc.
                Timer frequency will be set automatically based on selected ODR.

        config PROJECT_BF_BMI270_DEBUG_PIN_EN
            bool "Enable Debug Pin for Timing Measurement"
            default n
            depends on L1_MIDDLEWARE_01_MODULE_03_DEBUGPIN_EN


        endif
```

## driverframework/L0_task/04_project/05_bf/imu270_pub/Kconfig
```kconfig
menuconfig PROJECT_BF_BMI270_EN
    bool "Enable BMI270 Betaflight-style IMU Sensor"
    default n
    select BSP_USING_SPI
    help
        Enable BMI270 IMU driver for Betaflight-style project (no FIFO, DRDY interrupt + register read).

    if PROJECT_BF_BMI270_EN

    config SENSOR_SPI_NAME_BMI270_BF
        string "BMI270 BF SPI bus name"
        default "spi1"

    config SENSOR_SPI_SLAVE_NAME_BMI270_BF
        string "BMI270 BF SPI device name"
        default "spi10"

    config SENSOR_BMI270_BF_SPI_MAX_HZ
        int "BMI270 BF SPI max frequency (Hz)"
        default 10000000
        range 100000 20000000

    config SENSOR_BMI270_BF_SPI_CS_PIN
        string "BMI270 BF SPI CS pin"
        default "PA4"

    config SENSOR_BMI270_BF_INT_PIN
        string "BMI270 BF interrupt pin"
        default "PA15"

    choice
        prompt "BMI270 BF output data rate"
        default SENSOR_BMI270_BF_ODR_800HZ
        help
            Select the IMU output data rate (ODR) for both accelerometer and gyro.
            Higher ODR improves bandwidth but increases CPU load.

    config SENSOR_BMI270_BF_ODR_800HZ
        bool "800 Hz"

    config SENSOR_BMI270_BF_ODR_1600HZ
        bool "1600 Hz"

    config SENSOR_BMI270_BF_ODR_3200HZ
        bool "3200 Hz"

    endchoice

    choice
        prompt "BMI270 BF trigger mode"
        default SENSOR_BMI270_BF_TRIGGER_INTERRUPT
        help
            Select how to trigger IMU data reading:
            - Interrupt: Use hardware interrupt (DRDY pin) for accurate timing
            - Software timer: Use software timer for polling (useful for debugging)

    config SENSOR_BMI270_BF_TRIGGER_INTERRUPT
        bool "Hardware interrupt (DRDY pin)"

    config SENSOR_BMI270_BF_TRIGGER_TIMER
        bool "Software timer"

    endchoice

    endif
```

## driverframework/L0_task/04_project/05_bf/mlog/Kconfig
```kconfig
menuconfig PROJECT_BF_MLOG_GYRO_EN
    bool "ENABLE: PROJECT_BF_MLOG_GYRO_EN"
    default n
    depends on TASK_TOOL_02_SD_MLOG
    help
        Enable Betaflight-style gyro data logging via mlog system.
        Records filtered and unfiltered gyro data (gyroADC and gyroADCf).

    if PROJECT_BF_MLOG_GYRO_EN
        comment "Mlog gyro logging is configured via parameter system (mlog_gyro_en)"

        config PROJECT_BF_MLOG_GYRO_DEBUG_PIN_EN
            bool "Enable Debug Pin for Mlog Push Timing Measurement"
            default n
            depends on L1_MIDDLEWARE_01_MODULE_03_DEBUGPIN_EN
            help
                Enable debug pin to measure mlog push data timing.
                The pin will toggle when batch push data (every 10 frames).

    endif
```

## driverframework/L0_task/04_project/05_bf/motor/kconfig
```kconfig
menuconfig PROJECT_BF_MOTOR_EN
    bool "ENABLE: PROJECT_BF_MOTOR_EN"
    default n
    depends on PROJECT_BF_PID_EN
    depends on PROJECT_BF_RC_EN
    help
        Enable Betaflight-style motor mixer and motor control thread.
        This module handles motor mixing from PID output and RC throttle,
        publishes mixed motor values via MCN, and writes to motor device.

    if PROJECT_BF_MOTOR_EN
        config PROJECT_BF_MOTOR_THREAD_STACK_SIZE
            int "Motor Thread Stack Size (bytes)"
            range 2048 8192
            default 4096
            help
                Stack size for the motor control thread in bytes. Default: 4096.

        config PROJECT_BF_MOTOR_THREAD_PRIORITY
            int "Motor Thread Priority"
            range 1 32
            default 6
            help
                Priority for the motor control thread. Higher number means higher priority. 
                Should be lower than PID thread. Default: 6.

        config PROJECT_BF_MOTOR_THREAD_TIMESLICE
            int "Motor Thread Time Slice (ticks)"
            range 1 100
            default 5
            help
                Time slice for the motor control thread in ticks. Default: 5.

        config PROJECT_BF_MOTOR_DEVICE_NAME
            string "Motor Device Name"
            default "dshot"
            help
                Device name for motor output (e.g., "dshot", "pwm"). Default: "dshot".

        # ======== DEBUG: ANOTC (ATKP) ========
        menuconfig PROJECT_BF_MOTOR_ANOTC_LOG_EN
            bool "DEBUG: ANOTC (ATKP) Logging"
            default n
            depends on PROJECT_BF_ANOTC_EN
            help
                Enable ANOTC telemetry logging for motor output values.

            if PROJECT_BF_MOTOR_ANOTC_LOG_EN
                config PROJECT_BF_MOTOR_ANOTC_LOG_GROUP
                    int "Log Group ID for Motor Output"
                    range 1 99
                    default 8
                    help
                        Set the group ID for motor output logging (1-99). Default: 8.

                config PROJECT_BF_MOTOR_ANOTC_LOG_PERIOD_MS
                    int "Motor Output Log Period (ms)"
                    range 1 1000
                    default 20
                    help
                        Period (in milliseconds) for motor output logging. Default: 20ms.
            endif

        # ======== DEBUG: MLOG (SD Card) ========
        menuconfig PROJECT_BF_MOTOR_MLOG_EN
            bool "DEBUG: MLOG (SD Card) Logging"
            default n
            help
                Enable mlog (SD card logging) for motor output data.

    endif
```

## driverframework/L0_task/04_project/05_bf/param/Kconfig
```kconfig
menuconfig PROJECT_BF_PARAM_EN
    bool "ENABLE: PROJECT_BF_PARAM_EN"
    default n
    help
        Enable Betaflight-style parameter system.

    if PROJECT_BF_PARAM_EN
        config PROJECT_MINIFLY_TASK05_PARAM_FLYER_BF_DEFAULT_EN
            bool "Enable Betaflight Default Parameters"
            default y
            help
                Enable Betaflight default parameter set including:
                - RC parameters (rates, expo, super rates, limits)
                - PID parameters (rate loop and angle loop)
                - IMU filter parameters
                - IMU calibration offset parameters
                - Mlog parameters
    endif
```

## driverframework/L0_task/04_project/05_bf/pid/Kconfig
```kconfig
menuconfig PROJECT_BF_PID_EN
    bool "ENABLE: PROJECT_BF_PID_EN"
    default n
    depends on PROJECT_BF_GYRO_FILTER_EN
    help
        Enable Betaflight-style PID controller.

    if PROJECT_BF_PID_EN
        config PROJECT_BF_PID_THREAD_STACK_SIZE
            int "PID Thread Stack Size (bytes)"
            range 2048 8192
            default 4096
            help
                Stack size for the PID controller thread in bytes. Default: 4096.

        config PROJECT_BF_PID_THREAD_PRIORITY
            int "PID Thread Priority"
            range 1 32
            default 7
            help
                Priority for the PID controller thread. Higher number means higher priority. 
                Should be lower than gyro filter thread. Default: 8.

        config PROJECT_BF_PID_THREAD_TIMESLICE
            int "PID Thread Time Slice (ticks)"
            range 1 100
            default 5
            help
                Time slice for the PID controller thread in ticks. Default: 5.

        config PROJECT_BF_PID_DEBUG_PIN_EN
            bool "ENABLE: PID Debug Pin"
            default n
            depends on L1_MIDDLEWARE_01_MODULE_03_DEBUGPIN_EN
            help
                Enable debug pin for PID task monitoring:
                - DEBUG1: PID thread execution frequency (~3.2kHz)
                  Toggles at pidMainLoop() while loop start/end

        config PROJECT_BF_PID_D_MAX_EN
            bool "ENABLE: D_MAX (Dynamic D-term Gain Boost)"
            default n
            help
                Enable D_MAX feature for dynamic D-term gain boost.
                D_MAX increases D-term gain when rapid changes are detected
                (e.g., propwash), helping to suppress oscillations.
                This feature is useful for improving stability during aggressive maneuvers.

        # ======== DEBUG: ANOTC (ATKP) ========
        menuconfig PROJECT_BF_PID_ANOTC_LOG_EN
            bool "DEBUG: ANOTC (ATKP) Logging"
            default n
            depends on PROJECT_BF_ANOTC_EN
            help
                Enable ANOTC telemetry logging for PID rate setpoint and actual rate.

            if PROJECT_BF_PID_ANOTC_LOG_EN

                menuconfig PROJECT_BF_PID_ANOTC_LOG_ANGULAR_RATE_EN
                    bool "DEBUG: ANOTC (ATKP) Angular Rate Logging"
                    default n
                    depends on PROJECT_BF_ANOTC_EN
                    help
                        Enable ANOTC telemetry logging for PID angular rate setpoint and actual rate.
                    
                    if PROJECT_BF_PID_ANOTC_LOG_ANGULAR_RATE_EN
                        config PROJECT_BF_PID_ANOTC_LOG_ANGULAR_RATE_GROUP
                            int "Log Group ID for Angular Rate Setpoint/Actual"
                            range 1 99
                            default 1
                            help
                                Set the group ID for angular rate setpoint/actual logging (1-99).
                                Default: 1.

                        config PROJECT_BF_PID_ANOTC_LOG_ANGULAR_RATE_PERIOD_MS
                            int "Angular Rate Log Period (ms)"
                            range 1 1000
                            default 20
                            help
                                Period (in milliseconds) for angular rate setpoint/actual logging. Default: 20ms.
                endif

                menuconfig PROJECT_BF_PID_ANOTC_LOG_PITCH_PIDF_EN
                    bool "DEBUG: ANOTC (ATKP) Pitch PIDF Logging"
                    default n
                    depends on PROJECT_BF_ANOTC_EN
                    help
                        Enable ANOTC telemetry logging for pitch axis PIDF (P, I, D, F) and sum data.
                    
                    if PROJECT_BF_PID_ANOTC_LOG_PITCH_PIDF_EN
                        config PROJECT_BF_PID_ANOTC_LOG_PITCH_PIDF_GROUP
                            int "Log Group ID for Pitch PIDF Data"
                            range 1 99
                            default 2
                            help
                                Set the group ID for pitch PIDF data logging (1-99).
                                Default: 2.

                        config PROJECT_BF_PID_ANOTC_LOG_PITCH_PIDF_PERIOD_MS
                            int "Pitch PIDF Log Period (ms)"
                            range 1 1000
                            default 20
                            help
                                Period (in milliseconds) for pitch PIDF data logging. Default: 20ms.
                endif

            endif
    endif
```

## driverframework/L0_task/04_project/05_bf/rateCtrl/Kconfig
```kconfig
menuconfig PROJECT_BF_RATE_CTRL_EN
    bool "ENABLE: PROJECT_BF_RATE_CTRL_EN"
    default n
    help
        Enable Betaflight-style rate control with angular velocity processing.

    if PROJECT_BF_RATE_CTRL_EN
        config PROJECT_BF_RATE_CTRL_GYRO_CALIBRATION_DURATION_MS
            int "Gyro Calibration Duration (ms)"
            range 500 5000
            default 1250
            help
                Duration in milliseconds for gyro calibration. Default: 1250ms (1.25 seconds).

        config PROJECT_BF_RATE_CTRL_GYRO_MOVEMENT_THRESHOLD
            int "Gyro Movement Calibration Threshold"
            range 0 200
            default 48
            help
                Standard deviation threshold for detecting movement during calibration. 
                If exceeded, calibration will restart. Set to 0 to disable movement detection.

        config PROJECT_BF_RATE_CTRL_GYRO_OFFSET_YAW
            int "Gyro Yaw Offset (centidegrees)"
            range -10000 10000
            default 0
            help
                Manual yaw axis offset in centidegrees. This value is subtracted from 
                the calibrated yaw zero point.

        config PROJECT_BF_RATE_CTRL_ANGULAR_VELOCITY_FILTER_SAMPLE_FREQ
            int "Angular Velocity Filter Sample Frequency (Hz)"
            range 100 1000
            default 333
            help
                Sample frequency for angular velocity low-pass filter in Hz.

        config PROJECT_BF_RATE_CTRL_ANGULAR_VELOCITY_FILTER_CUTOFF_FREQ
            int "Angular Velocity Filter Cutoff Frequency (Hz)"
            range 10 200
            default 50
            help
                Cutoff frequency for angular velocity low-pass filter in Hz.

        config PROJECT_BF_RATE_CTRL_DEBUG_PIN_EN
            bool "Enable Debug Pin for Filter Timing Measurement"
            default n
            depends on L1_MIDDLEWARE_01_MODULE_03_DEBUGPIN_EN
            help
                Enable debug pin to measure filter processing time.
                The pin will be set HIGH during filter processing and LOW otherwise.
    endif
```
