## driverframework/L0_task/01_demo/TASK_04_WQ/Kconfig
```kconfig
menuconfig TASK_DEMO_04_WQ_EN
    bool "ENABLE: TASK_DEMO_04_WQ_EN"
    default n
    help
        Enable rate control workqueue demo task.

    if TASK_DEMO_04_WQ_EN

        config WORK_TASK_WQ_WORKQUEUE_STACK_SIZE
            int "Workqueue stack size"
            default 1536
            help
                Stack size for the workqueue servicing rate control jobs.

        config WORK_TASK_WQ_WORKQUEUE_PRIORITY
            int "Workqueue priority"
            default 16
            help
                Thread priority for the workqueue servicing rate control jobs.

        config WORK_TASK_WQ_IMU_THREAD_STACK_SIZE
            int "IMU publisher thread stack size"
            default 1024
            help
                Stack size for the IMU publishing thread.

        config WORK_TASK_WQ_IMU_THREAD_PRIORITY
            int "IMU publisher thread priority"
            default 14
            help
                Runtime priority for the IMU publishing thread.

        config WORK_TASK_WQ_IMU_THREAD_TIMESLICE
            int "IMU publisher thread timeslice"
            default 20
            help
                Timeslice (ticks) used by the IMU publishing thread.

        config WORK_TASK_WQ_IMU_PUBLISH_INTERVAL_MS
            int "IMU publish interval (ms)"
            default 3000
            help
                Interval in milliseconds between IMU raw publishes.

    endif
```

## driverframework/L0_task/03_work/TASK_04_XL530X/Kconfig
```kconfig
menuconfig WORK_TASK_TOF_XL530X_EN
    bool "ENABLE: WORK_TASK_TOF_XL530X_EN"
    default n
    help
        Enable TOF XL530X sensor task that drives XL530X ToF sensor.
        When enabled, the system creates an independent thread to initialize
        and continuously read distance data from the sensor.

    if WORK_TASK_TOF_XL530X_EN

        config WORK_TASK_TOF_XL530X_I2C_NAME
            string "I2C bus device name"
            default "hwi2c1"
            help
                The I2C bus device name used to access XL530X sensor

        config WORK_TASK_TOF_XL530X_USE_INTERRUPT
            bool "Use hardware interrupt mode"
            default n
            help
                Enable hardware interrupt mode for data reading.
                If enabled (y), use GPIO hardware interrupt (0x88).
                If disabled (n), use register polling mode (0x00).

        config WORK_TASK_TOF_XL530X_AUTO_START
            bool "Auto start task on init"
            default y
            help
                If enabled (y), task will start automatically on system init.
                If disabled (n), task must be started manually via command 'tof start'.

        config WORK_TASK_TOF_XL530X_CMD_REFTOF_CALIB
            bool "Enable RefToF calibration command"
            default y
            depends on RT_USING_FINSH
            help
                Enable 'tof reftof' command for RefToF calibration.

        config WORK_TASK_TOF_XL530X_CMD_XTALK_CALIB
            bool "Enable Xtalk calibration command"
            default y
            depends on RT_USING_FINSH
            help
                Enable 'tof xtalk' command for Xtalk calibration.

        config WORK_TASK_TOF_XL530X_CMD_OFFSET_CALIB
            bool "Enable Offset calibration command"
            default y
            depends on RT_USING_FINSH
            help
                Enable 'tof offset' command for Offset calibration.

        config WORK_TASK_TOF_XL530X_CMD_GRADIENT_CALIB
            bool "Enable Gradient calibration command"
            default n
            depends on RT_USING_FINSH
            help
                Enable 'tof gradient' command for Gradient calibration.
                Requires VI530x_GRADIENTK_CALIBRATION to be defined.

        config WORK_TASK_TOF_XL530X_ANOTC_TELEM_EN
            bool "Enable ANOTC_TELEM output for TOF data"
            default y
            depends on TASK_TOOL_01_ANOTC_TELEM_EN
            help
                Enable ANOTC_TELEM output for TOF sensor data.
                If enabled, data will be sent via ANOTC_TELEM protocol.
                If disabled, data will be sent via rt_kprintf.

    endif
```

## driverframework/L0_task/03_work/TASK_05_XL5300_XINLIN/Kconfig
```kconfig
menuconfig WORK_TASK_TOF_XL5300_XINLIN_EN
    bool "ENABLE: WORK_TASK_TOF_XL5300_XINLIN_EN"
    default n
    help
        使能鑫霖 XL5300（软I2C方案）ToF 任务。
        启用后，会创建独立线程完成SDK初始化并持续读取测距数据。

    if WORK_TASK_TOF_XL5300_XINLIN_EN

        config WORK_TASK_TOF_XL5300_XINLIN_THREAD_STACK
            int "Thread stack size"
            default 3072
            help
                任务线程栈大小

        config WORK_TASK_TOF_XL5300_XINLIN_THREAD_PRIO
            int "Thread priority"
            default 20
            help
                任务线程优先级

    endif
```

## driverframework/L0_task/03_work/TASK_06_XL5300_ORINGE/Kconfig
```kconfig
menuconfig WORK_TASK_TOF_XL5300_ORINGE_EN
    bool "ENABLE: WORK_TASK_TOF_XL5300_ORINGE_EN"
    default n
    help
        Enable TOF XL5300_ORINGE sensor task that drives VI530x ToF sensor.
        When enabled, the system creates an independent thread to initialize
        and continuously read distance data from the sensor.

    if WORK_TASK_TOF_XL5300_ORINGE_EN

        config WORK_TASK_TOF_XL5300_ORINGE_I2C_NAME
            string "I2C bus device name"
            default "hwi2c1"
            help
                The I2C bus device name used to access XL5300_ORINGE sensor

        config WORK_TASK_TOF_XL5300_ORINGE_USE_INTERRUPT
            bool "Use hardware interrupt mode"
            default n
            help
                Enable hardware interrupt mode for data reading.
                If enabled (y), use GPIO hardware interrupt (0x88).
                If disabled (n), use register polling mode (0x00).

        config WORK_TASK_TOF_XL5300_ORINGE_AUTO_START
            bool "Auto start task on init"
            default y
            help
                If enabled (y), task will start automatically on system init.
                If disabled (n), task must be started manually via command 'tof start'.

        config WORK_TASK_TOF_XL5300_ORINGE_CMD_REFTOF_CALIB
            bool "Enable RefToF calibration command"
            default y
            depends on RT_USING_FINSH
            help
                Enable 'tof reftof' command for RefToF calibration.

        config WORK_TASK_TOF_XL5300_ORINGE_CMD_XTALK_CALIB
            bool "Enable Xtalk calibration command"
            default y
            depends on RT_USING_FINSH
            help
                Enable 'tof xtalk' command for Xtalk calibration.

        config WORK_TASK_TOF_XL5300_ORINGE_CMD_OFFSET_CALIB
            bool "Enable Offset calibration command"
            default y
            depends on RT_USING_FINSH
            help
                Enable 'tof offset' command for Offset calibration.

        config WORK_TASK_TOF_XL5300_ORINGE_CMD_GRADIENT_CALIB
            bool "Enable Gradient calibration command"
            default n
            depends on RT_USING_FINSH
            help
                Enable 'tof gradient' command for Gradient calibration.
                Requires VI530x_GRADIENTK_CALIBRATION to be defined.

        config WORK_TASK_TOF_XL5300_ORINGE_UART_EN
            bool "Enable UART output for TOF data"
            default n
            help
                Enable UART output for TOF sensor data.
                If enabled, data will be sent via UART instead of rt_kprintf.

        if WORK_TASK_TOF_XL5300_ORINGE_UART_EN
            config WORK_TASK_TOF_XL5300_ORINGE_UART_NAME
                string "UART device name for TOF data output"
                default "uart1"
                help
                    UART device name for sending TOF sensor data.

            config WORK_TASK_TOF_XL5300_ORINGE_UART_BAUD
                int "UART baud rate for TOF data output"
                default 115200
                help
                    UART baud rate for TOF data transmission.
        endif

    endif
```

## driverframework/L0_task/03_work/TASK_07_esc_monitor/Kconfig
```kconfig
menuconfig WORK_TASK_ESC_MONITOR_EN
    bool "ENABLE: WORK_TASK_ESC_MONITOR_EN"
    default n
    help
        Enable ESC monitor task with I2C support

    if WORK_TASK_ESC_MONITOR_EN

        config WORK_TASK_ESC_MONITOR_I2C_NAME
            string "I2C bus device name"
            default "i2c1"
            help
                The I2C bus device name used by ESC monitor

        config WORK_TASK_ESC_MONITOR_I2C_ADDR
            hex "I2C device address"
            default 0x40
            help
                7-bit I2C device address used by ESC monitor

        config WORK_TASK_ESC_MONITOR_MODBUS_REG_INDEX
            int "Modbus holding register index"
            default 0
            help
                Holding register index used to report ESC monitor result

    endif
```

## driverframework/L0_task/03_work/TASK_08_opt3101/Kconfig
```kconfig
menuconfig WORK_TASK_OPT3101_EN
    bool "ENABLE: WORK_TASK_OPT3101"
    default n
    help
        Enable OPT3101 calibration and runtime support.

    if WORK_TASK_OPT3101_EN

        config WORK_TASK_OPT3101_I2C_NAME
            string "I2C bus device name"
            default "i2c1"
            help
                RT-Thread I2C bus device used to communicate with OPT3101.

        config WORK_TASK_OPT3101_I2C_ADDR
            hex "I2C device address"
            default 0x58
            help
                7-bit I2C address of OPT3101.

        config WORK_TASK_OPT3101_I2C_SPEED
            int "I2C bus speed (Hz)"
            range 100000 3400000
            default 400000
            help
                Target bus speed applied after the device is opened. Set to 0 to keep current driver configuration.

        config WORK_TASK_OPT3101_RESET_PIN
            string "Reset pin name (optional)"
            default ""
            help
                Optional RT-Thread pin name that drives OPT3101 reset (active low). Leave empty if not wired.

        config WORK_TASK_OPT3101_RESET_PULSE_MS
            int "Reset pulse width (ms)"
            default 5
            help
                Duration to hold reset pin low during resetDevice().

        config WORK_TASK_OPT3101_RESET_RELEASE_MS
            int "Reset release delay (ms)"
            default 10
            help
                Delay after releasing reset pin before next transaction.

        config WORK_TASK_OPT3101_FRAME_TIME_MS
            int "Frame interval estimate (ms)"
            default 30
            help
                Estimated frame period used to translate data ready counts to delay.

        config WORK_TASK_OPT3101_PAUSE_DELAY_MS
            int "Pause delay (ms)"
            default 10
            help
                Delay inserted by hostController::pause() in lieu of blocking for user input.

        config WORK_TASK_OPT3101_VERBOSE
            bool "Enable verbose logging"
            default y
            help
                Enable host.printf outputs for diagnostics.

        config WORK_TASK_OPT3101_PARAM_SAVE_EN
            bool "Enable saving calibration registers to parameter storage"
            default y
            help
                Capture calibration register snapshots into TASK_05_PARAM opt3101 parameter.

    endif
```

## driverframework/L0_task/03_work/TASK_09_mag_show/Kconfig
```kconfig
menuconfig WORK_TASK_MAG_REPORT_EN
    bool "ENABLE: WORK_TASK_MAG_REPORT_EN"
    default n
    help
       open mag report task

    if WORK_TASK_MAG_REPORT_EN

        config TASK_MAG_DEVICE_NAME
            string "Magnetometer device name"
            default "qmc6308"
            help
                Magnetometer device name used by rt_device_find.
                Valid values: qmc6308, qmc5883l.

        config TASK_MAG_ATKP_LOG_EN
            bool "Enable ATKP logging for magnetometer data"
            default n
            help
                Enable ATKP logging for magnetometer data transmission

            if TASK_MAG_ATKP_LOG_EN
                config TASK_MAG_ATKP_CHANNEL
                    int "ATKP channel number for magnetometer data"
                    range 1 8
                    default 2
                    help
                        ATKP channel number (1-8) for sending magnetometer data
            endif

        config TASK_MAG_SD_EVAL_UART_NAME
            string "UART device for SD influence evaluation stream"
            default "uart1"
            help
                UART device used to output raw magnetometer data for the PC evaluation tool.

        config TASK_MAG_SD_EVAL_UART_BAUD
            int "UART baudrate for SD influence evaluation stream"
            default 115200
            help
                Baudrate used by the evaluation data stream.

        config TASK_MAG_SD_EVAL_STREAM_PERIOD_MS
            int "Output period for SD influence evaluation stream (ms)"
            range 1 1000
            default 20
            help
                Output period in milliseconds for raw magnetometer data on the evaluation UART.

    endif
```

## driverframework/L0_task/04_project/01_basic/TASK_05_PARAM/Kconfig
```kconfig
menuconfig PROJECT_MINIFLY_TASK05_PARAM_EN
    bool "ENABLE: PROJECT_MINIFLY_TASK05_PARAM_EN"
    default n
    help
       open param config task
    if PROJECT_MINIFLY_TASK05_PARAM_EN
        config PROJECT_MINIFLY_TASK05_PARAM_FLYER_DEFAULT_EN
            bool "ENABLE: PROJECT_MINIFLY_TASK05_PARAM_FLYER_DEFAULT_EN"
            default n
            help
                "enable flyer default parameters"

        config PROJECT_MINIFLY_TASK05_PARAM_AUTO_SAVE_EN
        bool "ENABLE: PROJECT_MINIFLY_TASK05_PARAM_AUTO_SAVE_EN"
        default n
        help
            "enable auto save param to flash"

        config PROJECT_MINIFLY_TASK05_PARAM_OPT3101_EN
            bool "ENABLE: PROJECT_MINIFLY_TASK05_PARAM_OPT3101_EN"
            default y if WORK_TASK_OPT3101_PARAM_SAVE_EN
            help
                "enable OPT3101 calibration parameter set"
    endif
```

## driverframework/L0_task/04_project/04_px4/01_TASK_RATE_CONTROL/Kconfig
```kconfig
menuconfig PROJECT_PX4_TASK_RATE_CONTROL_EN
    bool "ENABLE: PROJECT_PX4_TASK_RATE_CONTROL_EN"
    default n
    help
        Enable rate control task that periodically calls MulticopterRateControl::Run().
        
    if PROJECT_PX4_TASK_RATE_CONTROL_EN
        config PROJECT_PX4_TASK_RATE_CONTROL_PERIOD_MS
            int "Rate Control Task Period (ms)"
            range 1 100
            default 4
            help
                Period (in milliseconds) for rate control task execution. Default: 4ms (250Hz).

        config PROJECT_PX4_TASK_RATE_CONTROL_PRIORITY
            int "Rate Control Task Priority"
            range 1 32
            default 5
            help
                RT-Thread task priority for rate control task. Higher number = higher priority.

        config PROJECT_PX4_TASK_RATE_CONTROL_STACK_SIZE
            int "Rate Control Task Stack Size (bytes)"
            range 1024 16384
            default 4096
            help
                Stack size for rate control task thread.

        config PROJECT_PX4_TASK_RATE_CONTROL_DEBUGPIN_EN
            bool "ENABLE: Debug Pin Support"
            default n
            help
                Enable debug pin output for rate control task timing.
    endif
```
