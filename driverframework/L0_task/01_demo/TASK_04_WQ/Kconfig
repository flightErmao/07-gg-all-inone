## driverframework/L0_task/04_project/05_bf/rc/Kconfig
```kconfig
menuconfig PROJECT_BF_RC_EN
    bool "ENABLE: PROJECT_BF_RC_EN"
    default n
    help
        Enable Betaflight-style RC processing with thread support.

    if PROJECT_BF_RC_EN
        config PROJECT_BF_RC_DEVICE_NAME
            string "RC Device Name"
            default "sbus"
            help
                Name of the RC device to open. Default: "rc"

        config PROJECT_BF_RC_THREAD_STACK_SIZE
            int "RC Thread Stack Size (bytes)"
            range 2048 8192
            default 2048
            help
                Stack size for the RC processing thread in bytes. Default: 2048.

        config PROJECT_BF_RC_THREAD_PRIORITY
            int "RC Thread Priority"
            range 1 32
            default 10
            help
                Priority for the RC processing thread. Higher number means higher priority.
                Should be lower than PID thread. Default: 7.

        config PROJECT_BF_RC_THREAD_TIMESLICE
            int "RC Thread Time Slice (ticks)"
            range 1 100
            default 5
            help
                Time slice for the RC processing thread in ticks. Default: 5.

        config PROJECT_BF_RC_DEBUG_PIN_EN
            bool "ENABLE: RC Debug Pin"
            default n
            depends on L1_MIDDLEWARE_01_MODULE_03_DEBUGPIN_EN
            help
                Enable debug pin for RC task monitoring:
                - DEBUG0: RC thread execution frequency (~100-200Hz)
                  Toggles at rcThreadEntry() while loop start/end
                - DEBUG1: subTaskRcCommand execution frequency (~1-4kHz)
                  Toggles at processRcCommand() start/end (called by PID task)
                  This covers both processRcCommand() and processRcSmoothingFilter()
    endif
```

## driverframework/L0_task/04_project/05_bf/testThread/Kconfig
```kconfig
menuconfig PROJECT_BF_TEST_THREAD_EN
    bool "ENABLE: PROJECT_BF_TEST_THREAD_EN"
    default n
    help
        Enable test thread for subscribing imu_raw MCN topic and logging via mlog_gyro.

    if PROJECT_BF_TEST_THREAD_EN
        config PROJECT_BF_TEST_THREAD_STACK_SIZE
            int "Test Thread Stack Size (bytes)"
            range 512 4096
            default 2048
            help
                Stack size for the test thread in bytes. Default: 2048.

        config PROJECT_BF_TEST_THREAD_PRIORITY
            int "Test Thread Priority"
            range 1 32
            default 10
            help
                Priority for the test thread. Higher number means higher priority. Default: 10.

        config PROJECT_BF_TEST_THREAD_TIMESLICE
            int "Test Thread Time Slice (ticks)"
            range 1 100
            default 5
            help
                Time slice for the test thread in ticks. Default: 5.

        config PROJECT_BF_TEST_THREAD_DEBUG_PIN_EN
            bool "Enable Debug Pin for Mlog Timing Measurement"
            default y
            depends on L1_MIDDLEWARE_01_MODULE_03_DEBUGPIN_EN
            help
                Enable debug pin to measure mlog push data timing.
                The pin will be set HIGH during mlog push and LOW otherwise.
                Default: enabled.
    endif
```

## driverframework/L0_task/04_project/05_bf/workqueueManage/Kconfig
```kconfig
menuconfig PROJECT_BF_WORKQUEUE_MANAGE_EN
    bool "ENABLE: PROJECT_BF_WORKQUEUE_MANAGE_EN"
    default n
    help
        Enable workqueue management system.
        Individual workqueues can be configured below.

    if PROJECT_BF_WORKQUEUE_MANAGE_EN

        # 速率控制工作队列
        config PROJECT_BF_WORKQUEUE_RATE_CTRL_EN
            bool "Enable Rate Control Workqueue"
            default y
            help
                Enable workqueue for rate control tasks.

        if PROJECT_BF_WORKQUEUE_RATE_CTRL_EN
            config PROJECT_BF_WORKQUEUE_RATE_CTRL_NAME
                string "Rate Control Workqueue Name"
                default "wq_rate_ctrl"
                help
                    Name of the workqueue for rate control jobs.

            config PROJECT_BF_WORKQUEUE_RATE_CTRL_STACK_SIZE
                int "Rate Control Workqueue Stack Size"
                range 512 4096
                default 1536
                help
                    Stack size for the rate control workqueue.

            config PROJECT_BF_WORKQUEUE_RATE_CTRL_PRIORITY
                int "Rate Control Workqueue Priority"
                range 1 32
                default 16
                help
                    Thread priority for the rate control workqueue.
                    Higher number = higher priority.
        endif

        # 可以在这里添加更多工作队列配置
        # 例如：
        # config PROJECT_BF_WORKQUEUE_SENSOR_EN
        #     bool "Enable Sensor Workqueue"
        #     default n
        #
        # if PROJECT_BF_WORKQUEUE_SENSOR_EN
        #     config PROJECT_BF_WORKQUEUE_SENSOR_NAME
        #         string "Sensor Workqueue Name"
        #         default "wq_sensor"
        #     ...
        # endif

    endif
```
