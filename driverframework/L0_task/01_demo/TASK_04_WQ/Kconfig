## driverframework/L0_task/04_project/05_bf/acc/Kconfig
```kconfig
menuconfig PROJECT_BF_ACC_EN
    bool "ENABLE: PROJECT_BF_ACC_EN"
    default n
    help
        Enable Betaflight-style accelerometer processing with alignment, calibration, trim, and PT2 filtering.

    if PROJECT_BF_ACC_EN
        config PROJECT_BF_ACC_CALIBRATION_DURATION_MS
            int "Accelerometer Calibration Duration (ms)"
            range 500 5000
            default 2000
            help
                Duration in milliseconds for accelerometer calibration. Default: 2000ms (2 seconds).

        config PROJECT_BF_ACC_DEBUG_PIN_EN
            bool "Enable Debug Pin for Acc Processing Timing Measurement"
            default n
            depends on L1_MIDDLEWARE_01_MODULE_03_DEBUGPIN_EN
            help
                Enable debug pin to measure accelerometer processing time.
                The pin will be set HIGH during processing and LOW otherwise.

        config PROJECT_BF_ACC_THREAD_STACK_SIZE
            int "Accelerometer Thread Stack Size (bytes)"
            range 1024 8192
            default 2048
            help
                Stack size for the accelerometer processing thread in bytes. Default: 2048.

        config PROJECT_BF_ACC_THREAD_PRIORITY
            int "Accelerometer Thread Priority"
            range 1 32
            default 12
            help
                Priority for the accelerometer processing thread. Higher number means higher priority. Default: 10.

        config PROJECT_BF_ACC_THREAD_TIMESLICE
            int "Accelerometer Thread Time Slice (ticks)"
            range 1 100
            default 5
            help
                Time slice for the accelerometer processing thread in ticks. Default: 5.
    endif
```

## driverframework/L0_task/04_project/05_bf/anotc/Kconfig
```kconfig
menuconfig PROJECT_BF_ANOTC_EN
    bool "ENABLE: PROJECT_BF_ANOTC_EN"
    default n
    help
        Enable ANOTC telemetry with thread support.

    if PROJECT_BF_ANOTC_EN
        config PROJECT_BF_ANOTC_DEVICE_DEFAULT
            string "the default of send device"
            default "uart2"
            help
                "the default of send device"

        config PROJECT_BF_ANOTC_BAUD_RATE
            int "the baud rate of send device"
            default 1000000
            help
                "the baud rate of send device"

        config PROJECT_BF_ANOTC_REC_THREAD_STACK_SIZE
            int "ANOTC Rec Thread Stack Size (bytes)"
            range 2048 8192
            default 2048
            help
                Stack size for the ANOTC receive thread in bytes. Default: 2048.

        config PROJECT_BF_ANOTC_REC_THREAD_PRIORITY
            int "ANOTC Rec Thread Priority"
            range 1 32
            default 25
            help
                Priority for the ANOTC receive thread. Higher number means higher priority.
                Default: 25.

        config PROJECT_BF_ANOTC_REC_THREAD_TIMESLICE
            int "ANOTC Rec Thread Time Slice (ticks)"
            range 1 100
            default 5
            help
                Time slice for the ANOTC receive thread in ticks. Default: 5.

        config PROJECT_BF_ANOTC_SEND_THREAD_STACK_SIZE
            int "ANOTC Send Thread Stack Size (bytes)"
            range 2048 8192
            default 2048
            help
                Stack size for the ANOTC send thread in bytes. Default: 2048.

        config PROJECT_BF_ANOTC_SEND_THREAD_PRIORITY
            int "ANOTC Send Thread Priority"
            range 1 32
            default 24
            help
                Priority for the ANOTC send thread. Higher number means higher priority.
                Default: 24.

        config PROJECT_BF_ANOTC_SEND_THREAD_TIMESLICE
            int "ANOTC Send Thread Time Slice (ticks)"
            range 1 100
            default 5
            help
                Time slice for the ANOTC send thread in ticks. Default: 5.

        config PROJECT_BF_ANOTC_CUT_DEV
            bool "ENABLE: PROJECT_BF_ANOTC_CUT_DEV"
            default n
            help
                Enable shell command to switch output device.
    endif
```

## driverframework/L0_task/04_project/05_bf/attitude/Kconfig
```kconfig
menuconfig PROJECT_BF_ATTITUDE_EN
    bool "ENABLE: PROJECT_BF_ATTITUDE_EN"
    default n
    depends on PROJECT_BF_GYRO_FILTER_EN
    help
        Enable Betaflight-style attitude estimation (roll/pitch angle calculation).
        This module fuses accelerometer and gyroscope data to estimate aircraft attitude.

    if PROJECT_BF_ATTITUDE_EN
        config PROJECT_BF_ATTITUDE_UPDATE_FREQ_HZ
            int "Attitude Update Frequency (Hz)"
            range 100 2000
            default 500
            help
                Frequency for attitude estimation update in Hz.
                Higher frequency improves responsiveness but increases CPU load.
                Betaflight uses 500Hz by default. Default: 500.

        config PROJECT_BF_ATTITUDE_DEBUG_PIN_EN
            bool "Enable Debug Pin for Attitude Timing Measurement"
            default n
            depends on L1_MIDDLEWARE_01_MODULE_03_DEBUGPIN_EN
            help
                Enable debug pin to measure attitude processing time.
                The pin will be set HIGH during attitude processing and LOW otherwise.

        config PROJECT_BF_ATTITUDE_THREAD_STACK_SIZE
            int "Attitude Thread Stack Size (bytes)"
            range 2048 8192
            default 4096
            help
                Stack size for the attitude estimation thread in bytes. Default: 4096.

        config PROJECT_BF_ATTITUDE_THREAD_PRIORITY
            int "Attitude Thread Priority"
            range 1 32
            default 10
            help
                Priority for the attitude estimation thread. Higher number means higher priority.
                Should be lower than motor thread (6). Default: 10.

        config PROJECT_BF_ATTITUDE_THREAD_TIMESLICE
            int "Attitude Thread Time Slice (ticks)"
            range 1 100
            default 5
            help
                Time slice for the attitude estimation thread in ticks. Default: 5.

        # ======== DEBUG: ANOTC (ATKP) ========
        menuconfig PROJECT_BF_ATTITUDE_ANOTC_LOG_EN
            bool "DEBUG: ANOTC (ATKP) Logging"
            default n
            depends on PROJECT_BF_ANOTC_EN
            help
                Enable ANOTC telemetry logging for attitude data (roll/pitch angles).

            if PROJECT_BF_ATTITUDE_ANOTC_LOG_EN
                config PROJECT_BF_ATTITUDE_ANOTC_LOG_PERIOD_MS
                    int "Attitude Log Period (ms)"
                    range 1 1000
                    default 20
                    help
                        Period (in milliseconds) for attitude data logging. Default: 20ms.
            endif
    endif
```

## driverframework/L0_task/04_project/05_bf/common/Kconfig
```kconfig
config PROJECT_BF_COMMON_EN
    bool
    default n
    help
        Automatically enabled when any BF module is active.
        Provides shared init_sync mechanism for BF modules.
```

## driverframework/L0_task/04_project/05_bf/gyro/Kconfig
```kconfig
menuconfig PROJECT_BF_GYRO_FILTER_EN
    bool "ENABLE: PROJECT_BF_GYRO_FILTER_EN"
    default n
    select PROJECT_BF_COMMON_EN
    help
        Enable Betaflight-style gyro filter with angular velocity processing.

    if PROJECT_BF_GYRO_FILTER_EN
        config PROJECT_BF_GYRO_FILTER_CALIBRATION_DURATION_MS
            int "Gyro Calibration Duration (ms)"
            range 500 5000
            default 1250
            help
                Duration in milliseconds for gyro calibration. Default: 1250ms (1.25 seconds).

        config PROJECT_BF_GYRO_FILTER_MOVEMENT_THRESHOLD
            int "Gyro Movement Calibration Threshold"
            range 0 200
            default 48
            help
                Standard deviation threshold for detecting movement during calibration. 
                If exceeded, calibration will restart. Set to 0 to disable movement detection.

        config PROJECT_BF_GYRO_FILTER_OFFSET_YAW
            int "Gyro Yaw Offset (centidegrees)"
            range -10000 10000
            default 0
            help
                Manual yaw axis offset in centidegrees. This value is subtracted from 
                the calibrated yaw zero point.

        config PROJECT_BF_GYRO_FILTER_ANGULAR_VELOCITY_FILTER_SAMPLE_FREQ
            int "Angular Velocity Filter Sample Frequency (Hz)"
            range 100 1000
            default 333
            help
                Sample frequency for angular velocity low-pass filter in Hz.

        config PROJECT_BF_GYRO_FILTER_ANGULAR_VELOCITY_FILTER_CUTOFF_FREQ
            int "Angular Velocity Filter Cutoff Frequency (Hz)"
            range 10 200
            default 50
            help
                Cutoff frequency for angular velocity low-pass filter in Hz.

        config PROJECT_BF_GYRO_FILTER_DEBUG_PIN_EN
            bool "Enable Debug Pin for Filter Timing Measurement"
            default n
            depends on L1_MIDDLEWARE_01_MODULE_03_DEBUGPIN_EN
            help
                Enable debug pin to measure filter processing time.
                The pin will be set HIGH during filter processing and LOW otherwise.

        config PROJECT_BF_GYRO_FILTER_THREAD_STACK_SIZE
            int "Gyro Filter Thread Stack Size (bytes)"
            range 1024 8192
            default 2048
            help
                Stack size for the gyro filter thread in bytes. Default: 2048.

        config PROJECT_BF_GYRO_FILTER_THREAD_PRIORITY
            int "Gyro Filter Thread Priority"
            range 1 32
            default 6
            help
                Priority for the gyro filter thread. Higher number means higher priority. Default: 10.

        config PROJECT_BF_GYRO_FILTER_THREAD_TIMESLICE
            int "Gyro Filter Thread Time Slice (ticks)"
            range 1 100
            default 5
            help
                Time slice for the gyro filter thread in ticks. Default: 5.

        menuconfig PROJECT_BF_GYRO_FILTER_ADVANCED
            bool "Advanced Gyro Filter Options"
            default n
            help
                Enable advanced gyro filter options including dynamic LPF and dynamic notch filter.

            if PROJECT_BF_GYRO_FILTER_ADVANCED
                config USE_DYN_LPF
                    bool "Enable Dynamic Low-Pass Filter (DYN_LPF)"
                    default n
                    help
                        Enable dynamic low-pass filter that adjusts cutoff frequency based on gyro activity.
                        This allows the filter to adapt to different flight conditions automatically.

                config USE_DYN_NOTCH_FILTER
                    bool "Enable Dynamic Notch Filter"
                    default n
                    help
                        Enable dynamic notch filter that automatically detects and filters motor noise frequencies.
                        This is useful for removing motor-induced vibrations from gyro data.
        endif

        menuconfig PROJECT_BF_MLOG_GYRO_EN
            bool "ENABLE: PROJECT_BF_MLOG_GYRO_EN"
            default y
            depends on TASK_TOOL_02_SD_MLOG
            help
                Enable Betaflight-style gyro data logging via mlog system.
                Records filtered and unfiltered gyro data (gyroADC and gyroADCf).

            if PROJECT_BF_MLOG_GYRO_EN
                comment "Mlog gyro logging is configured via parameter system (mlog_gyro_en)"

                config PROJECT_BF_MLOG_GYRO_DEBUG_PIN_EN
                    bool "Enable Debug Pin for Mlog Push Timing Measurement"
                    default n
                    depends on L1_MIDDLEWARE_01_MODULE_03_DEBUGPIN_EN
                    help
                        Enable debug pin to measure mlog push data timing.
                        The pin will toggle when batch push data (every 10 frames).

            endif
    endif
```

## driverframework/L0_task/04_project/05_bf/gyroFilter/Kconfig
```kconfig
menuconfig PROJECT_BF_GYRO_FILTER_EN
    bool "ENABLE: PROJECT_BF_GYRO_FILTER_EN"
    default n
    help
        Enable Betaflight-style gyro filter with angular velocity processing.

    if PROJECT_BF_GYRO_FILTER_EN
        config PROJECT_BF_GYRO_FILTER_CALIBRATION_DURATION_MS
            int "Gyro Calibration Duration (ms)"
            range 500 5000
            default 1250
            help
                Duration in milliseconds for gyro calibration. Default: 1250ms (1.25 seconds).

        config PROJECT_BF_GYRO_FILTER_MOVEMENT_THRESHOLD
            int "Gyro Movement Calibration Threshold"
            range 0 200
            default 48
            help
                Standard deviation threshold for detecting movement during calibration. 
                If exceeded, calibration will restart. Set to 0 to disable movement detection.

        config PROJECT_BF_GYRO_FILTER_OFFSET_YAW
            int "Gyro Yaw Offset (centidegrees)"
            range -10000 10000
            default 0
            help
                Manual yaw axis offset in centidegrees. This value is subtracted from 
                the calibrated yaw zero point.

        config PROJECT_BF_GYRO_FILTER_ANGULAR_VELOCITY_FILTER_SAMPLE_FREQ
            int "Angular Velocity Filter Sample Frequency (Hz)"
            range 100 1000
            default 333
            help
                Sample frequency for angular velocity low-pass filter in Hz.

        config PROJECT_BF_GYRO_FILTER_ANGULAR_VELOCITY_FILTER_CUTOFF_FREQ
            int "Angular Velocity Filter Cutoff Frequency (Hz)"
            range 10 200
            default 50
            help
                Cutoff frequency for angular velocity low-pass filter in Hz.

        config PROJECT_BF_GYRO_FILTER_DEBUG_PIN_EN
            bool "Enable Debug Pin for Filter Timing Measurement"
            default n
            depends on L1_MIDDLEWARE_01_MODULE_03_DEBUGPIN_EN
            help
                Enable debug pin to measure filter processing time.
                The pin will be set HIGH during filter processing and LOW otherwise.

        config PROJECT_BF_GYRO_FILTER_THREAD_STACK_SIZE
            int "Gyro Filter Thread Stack Size (bytes)"
            range 1024 8192
            default 2048
            help
                Stack size for the gyro filter thread in bytes. Default: 2048.

        config PROJECT_BF_GYRO_FILTER_THREAD_PRIORITY
            int "Gyro Filter Thread Priority"
            range 1 32
            default 10
            help
                Priority for the gyro filter thread. Higher number means higher priority. Default: 10.

        config PROJECT_BF_GYRO_FILTER_THREAD_TIMESLICE
            int "Gyro Filter Thread Time Slice (ticks)"
            range 1 100
            default 5
            help
                Time slice for the gyro filter thread in ticks. Default: 5.
    endif
```
