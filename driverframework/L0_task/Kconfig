## driverframework/L0_task/Kconfig
```kconfig
menu "L0_TASK_CONFIG"
    source "$(PROJECT_ROOT)/driverframework/L0_task/01_demo/TASK_01_LED_BLINK/Kconfig"
    source "$(PROJECT_ROOT)/driverframework/L0_task/01_demo/TASK_02_UART_TEST/Kconfig"
    source "$(PROJECT_ROOT)/driverframework/L0_task/01_demo/TASK_03_SPI_TEST/Kconfig"
    source "$(PROJECT_ROOT)/driverframework/L0_task/01_demo/TASK_04_WQ/Kconfig"

    source "$(PROJECT_ROOT)/driverframework/L0_task/02_tools/TASK_01_ANOTC_TELEM/Kconfig"
    source "$(PROJECT_ROOT)/driverframework/L0_task/02_tools/TASK_02_SD_MLOG/Kconfig"

    source "$(PROJECT_ROOT)/driverframework/L0_task/03_work/TASK_01_GPS_TEST/Kconfig"
    source "$(PROJECT_ROOT)/driverframework/L0_task/03_work/TASK_02_BARO_SHOW/Kconfig"
    source "$(PROJECT_ROOT)/driverframework/L0_task/03_work/TASK_03_MAG_RTK/Kconfig"
    source "$(PROJECT_ROOT)/driverframework/L0_task/03_work/TASK_04_XL530X/Kconfig"
    source "$(PROJECT_ROOT)/driverframework/L0_task/03_work/TASK_05_XL5300_XINLIN/Kconfig"
    source "$(PROJECT_ROOT)/driverframework/L0_task/03_work/TASK_06_XL5300_ORINGE/Kconfig"
    source "$(PROJECT_ROOT)/driverframework/L0_task/03_work/TASK_07_esc_monitor/Kconfig"
    source "$(PROJECT_ROOT)/driverframework/L0_task/03_work/TASK_09_mag_show/Kconfig"

    source "$(PROJECT_ROOT)/driverframework/L0_task/04_project/01_basic/TASK_01_SENSOR/Kconfig"
    source "$(PROJECT_ROOT)/driverframework/L0_task/04_project/01_basic/TASK_02_STABLIZE/Kconfig"
    source "$(PROJECT_ROOT)/driverframework/L0_task/04_project/01_basic/TASK_03_NRF_REC/Kconfig"
    source "$(PROJECT_ROOT)/driverframework/L0_task/04_project/01_basic/TASK_04_DISTRIBUTE/Kconfig"
    source "$(PROJECT_ROOT)/driverframework/L0_task/04_project/01_basic/TASK_05_PARAM/Kconfig"
    source "$(PROJECT_ROOT)/driverframework/L0_task/04_project/01_basic/TASK_06_RC/Kconfig"

    source "$(PROJECT_ROOT)/driverframework/L0_task/04_project/02_fmt/01_TASK_RC/Kconfig"

    source "$(PROJECT_ROOT)/driverframework/L0_task/04_project/03_fpv/01_TASK_DSHOT/Kconfig"
    source "$(PROJECT_ROOT)/driverframework/L0_task/04_project/03_fpv/02_HARDWARE_TIMER/Kconfig"

    source "$(PROJECT_ROOT)/driverframework/L0_task/04_project/04_px4/imu_pub/Kconfig"
    
    source "$(PROJECT_ROOT)/driverframework/L0_task/04_project/05_bf/imu/Kconfig"
    source "$(PROJECT_ROOT)/driverframework/L0_task/04_project/05_bf/gyroFilter/Kconfig"
    source "$(PROJECT_ROOT)/driverframework/L0_task/04_project/05_bf/log/Kconfig"
    source "$(PROJECT_ROOT)/driverframework/L0_task/04_project/05_bf/pid/Kconfig"
    source "$(PROJECT_ROOT)/driverframework/L0_task/04_project/05_bf/rc/Kconfig"
    source "$(PROJECT_ROOT)/driverframework/L0_task/04_project/05_bf/param/Kconfig"
endmenu
```

## driverframework/L1_middleWare/04_px4_module/01_mc_rate_control/Kconfig
```kconfig
menuconfig L1_MIDDLEWARE_04_PX4_MODULE_01_MC_RATE_CONTROL_EN
    bool "ENABLE: L1_MIDDLEWARE_04_PX4_MODULE_01_MC_RATE_CONTROL_EN"
    default n
    help
        Enable multicopter rate control module.
```

## driverframework/L1_middleWare/04_px4_module/04_sensor_vehicleAngularVelocity/Kconfig
```kconfig
menuconfig L1_MIDDLEWARE_04_PX4_MODULE_04_SENSOR_VEHICLE_ANGULAR_VELOCITY_EN
    bool "ENABLE: L1_MIDDLEWARE_04_PX4_MODULE_04_SENSOR_VEHICLE_ANGULAR_VELOCITY_EN"
    default n
    select L1_MIDDLEWARE_05_PX4_LIB_02_MATHLIB_EN
    help
        Enable PX4 angular velocity filter wrapper support.
```

## driverframework/L1_middleWare/05_px4_lib/02_mathlib/Kconfig
```kconfig
menuconfig L1_MIDDLEWARE_05_PX4_LIB_02_MATHLIB_EN
    bool "ENABLE: L1_MIDDLEWARE_05_PX4_LIB_02_MATHLIB_EN"
    default n
    help
        Enable PX4 math library support.
```

## driverframework/L1_middleWare/05_px4_lib/03_matrix/Kconfig
```kconfig
menuconfig L1_MIDDLEWARE_05_PX4_LIB_03_MATRIX_EN
    bool "ENABLE: L1_MIDDLEWARE_05_PX4_LIB_03_MATRIX_EN"
    default n
    help
        Enable PX4 matrix library support.
        This library provides matrix operations including Vector3f, Vector4f, etc.
```

## driverframework/L1_middleWare/06_bf_lib/common/Kconfig
```kconfig
menuconfig L1_MIDDLEWARE_06_BF_LIB_COMMON_EN
    bool "ENABLE: L1_MIDDLEWARE_06_BF_LIB_COMMON_EN"
    default y
    help
        Enable Betaflight common library support (filter, maths, etc.).
```

## driverframework/L1_middleWare/06_bf_lib/filter_imu/Kconfig
```kconfig
menuconfig L1_MIDDLEWARE_06_BF_LIB_FILTER_IMU_EN
    bool "ENABLE: L1_MIDDLEWARE_06_BF_LIB_FILTER_IMU_EN"
    default n
    help
        Enable Betaflight-style IMU filter library support.
```

## driverframework/L1_middleWare/06_bf_lib/sensor/Kconfig
```kconfig
menuconfig L1_MIDDLEWARE_06_BF_LIB_SENSOR_EN
    bool "ENABLE: L1_MIDDLEWARE_06_BF_LIB_SENSOR_EN"
    default y
    depends on L1_MIDDLEWARE_06_BF_LIB_COMMON_EN
    help
        Enable Betaflight sensor alignment library support.
        This module provides sensor alignment functions for accelerometer and gyroscope.
```

## driverframework/L2_device/01_IMU/05_BMI270_px4/Kconfig
```kconfig
config BSP_USING_BMI270_PX4
    bool "Enable BMI270 PX4 IMU Sensor"
    default n
    select BSP_USING_SPI
    help
        Enable BMI270 PX4 style IMU driver

if BSP_USING_BMI270_PX4

config SENSOR_NAME_BMI270_PX4
    string "BMI270 PX4 IMU device name"
    default "bmi270_px4"

config SENSOR_SPI_NAME_BMI270_PX4
    string "BMI270 PX4 SPI bus name"
    default "spi1"

config SENSOR_SPI_SLAVE_NAME_BMI270_PX4
    string "BMI270 PX4 SPI device name"
    default "spi10"

config SENSOR_BMI270_PX4_SPI_MAX_HZ
    int "BMI270 PX4 SPI max frequency (Hz)"
    default 10000000
    range 100000 20000000

config SENSOR_BMI270_PX4_SPI_CS_PIN
    string "BMI270 PX4 SPI CS pin"
    default "PA4"

config SENSOR_BMI270_PX4_INT_PIN
    string "BMI270 PX4 interrupt pin"
    default "PA15"

config SENSOR_BMI270_PX4_FIFO_WM
    int "BMI270 PX4 FIFO watermark samples"
    default 2
    range 2 32

endif
```

## driverframework/L2_device/01_IMU/05_ICM42688_new/Kconfig
```kconfig
config BSP_USING_ICM42688_NEW_ANY
    bool
    default y if BSP_USING_ICM42688_NEW || BSP_USING_ICM42688_NEW_2ND

config BSP_USING_ICM42688_NEW
    bool "Enable first ICM42688 IMU Sensor"
    default n
    select BSP_USING_SPI
    select RT_USING_ULOG
    help
        Enable the first ICM42688 IMU instance.

if BSP_USING_ICM42688_NEW
    config SENSOR_NAME_ICM42688
        string "IMU ICM42688 NAME FOR TASK FIND"
        default "ICM42688"

    config SENSOR_SPI_NAME_ICM42688
        string "IMU ICM42688 SPI NAME"
        default "spi1"

    config SENSOR_SPI_SLAVE_NAME_ICM42688
        string "IMU ICM42688 SPI SLAVE NAME"
        default "spi10"

    config SENSOR_ICM42688_SPI_MAX_HZ
        int "IMU ICM42688 SPI MAX CLOCK (Hz)"
        default 10000000
        range 100000 20000000

    config SENSOR_ICM42688_SPI_CS_PIN
        string "IMU ICM42688 SPI CS PIN"
        default "PA4"

    config SENSOR_ICM42688_DEBUGPIN_EN
        bool "ENABLE: DEBUG PIN"
        default n
        help
            ENABLE: DEBUG PIN
endif

config BSP_USING_ICM42688_NEW_2ND
    bool "Enable second ICM42688 IMU Sensor"
    default n
    select BSP_USING_SPI
    select RT_USING_ULOG
    help
        Enable the second ICM42688 IMU instance.

if BSP_USING_ICM42688_NEW_2ND
    config SENSOR_NAME_ICM42688_2ND
        string "Second IMU ICM42688 NAME FOR TASK FIND"
        default "ICM42688_2"

    config SENSOR_SPI_NAME_ICM42688_2ND
        string "Second IMU ICM42688 SPI NAME"
        default "spi1"

    config SENSOR_SPI_SLAVE_NAME_ICM42688_2ND
        string "Second IMU ICM42688 SPI SLAVE NAME"
        default "spi11"

    config SENSOR_ICM42688_SPI_MAX_HZ_2ND
        int "Second IMU ICM42688 SPI MAX CLOCK (Hz)"
        default 10000000
        range 100000 20000000

    config SENSOR_ICM42688_SPI_CS_PIN_2ND
        string "Second IMU ICM42688 SPI CS PIN"
        default "PA15"
endif
```

## driverframework/L2_device/01_IMU/06_45686/Kconfig
```kconfig
config BSP_USING_ICM45686_ANY
    bool
    default y if BSP_USING_ICM45686 || BSP_USING_ICM45686_2ND

config BSP_USING_ICM45686
    bool "Enable first ICM45686 IMU Sensor"
    default n
    select BSP_USING_SPI
    select RT_USING_ULOG
    help
        Enable the first ICM45686 IMU instance.

if BSP_USING_ICM45686
    config SENSOR_NAME_ICM45686
        string "IMU ICM45686 NAME FOR TASK FIND"
        default "45686_A"

    config SENSOR_SPI_NAME_ICM45686
        string "IMU ICM45686 SPI NAME"
        default "spi2"

    config SENSOR_SPI_SLAVE_NAME_ICM45686
        string "IMU ICM45686 SPI SLAVE NAME"
        default "spi21"

    config SENSOR_ICM45686_SPI_MAX_HZ
        int "IMU ICM45686 SPI MAX CLOCK (Hz)"
        default 10000000
        range 100000 24000000

    config SENSOR_ICM45686_SPI_CS_PIN
        string "IMU ICM45686 SPI CS PIN"
        default "PB11"

    config SENSOR_ICM45686_WHOAMI_REG
        hex "ICM45686 WHO_AM_I register"
        default 0x72

    config SENSOR_ICM45686_WHOAMI_EXPECTED
        hex "ICM45686 expected WHO_AM_I value"
        default 0xE9

    config SENSOR_ICM45686_DEBUGPIN_EN
        bool "ENABLE: DEBUG PIN"
        default n
        help
            ENABLE: DEBUG PIN
endif

config BSP_USING_ICM45686_2ND
    bool "Enable second ICM45686 IMU Sensor"
    default n
    select BSP_USING_SPI
    select RT_USING_ULOG
    help
        Enable the second ICM45686 IMU instance.

if BSP_USING_ICM45686_2ND
    config SENSOR_NAME_ICM45686_2ND
        string "Second IMU ICM45686 NAME FOR TASK FIND"
        default "45686_B"

    config SENSOR_SPI_NAME_ICM45686_2ND
        string "Second IMU ICM45686 SPI NAME"
        default "spi2"

    config SENSOR_SPI_SLAVE_NAME_ICM45686_2ND
        string "Second IMU ICM45686 SPI SLAVE NAME"
        default "spi22"

    config SENSOR_ICM45686_SPI_MAX_HZ_2ND
        int "Second IMU ICM45686 SPI MAX CLOCK (Hz)"
        default 10000000
        range 100000 24000000

    config SENSOR_ICM45686_SPI_CS_PIN_2ND
        string "Second IMU ICM45686 SPI CS PIN"
        default "PB12"

    config SENSOR_ICM45686_WHOAMI_REG_2ND
        hex "Second ICM45686 WHO_AM_I register"
        default 0x72

    config SENSOR_ICM45686_WHOAMI_EXPECTED_2ND
        hex "Second ICM45686 expected WHO_AM_I value"
        default 0xE9
endif
```

## driverframework/L2_device/01_IMU/Kconfig
```kconfig
menu "01 IMU CONFIG"
    config BSP_USING_IMU_CMD_CAL_GENERAL
        bool "Enable general IMU calibration command"
        default n

    config IMU_CAL_GENERAL_DEVICE_NAME
        string "IMU calibration device name"
        default "imu0"
        depends on BSP_USING_IMU_CMD_CAL_GENERAL

    menu "01 ICM42688_130 CONFIG"
        source "$(PROJECT_ROOT)/driverframework/L2_device/01_IMU/01_ICM42688_130/Kconfig"
    endmenu

    menu "02 MPU6500_minifly CONFIG"
        source "$(PROJECT_ROOT)/driverframework/L2_device/01_IMU/02_MPU6500_minifly/Kconfig"
    endmenu

    menu "03 MPU6000_FMUV2 CONFIG"
        source "$(PROJECT_ROOT)/driverframework/L2_device/01_IMU/03_MPU6000_FMUV2/Kconfig"
    endmenu

    menu "04 BMI270 CONFIG"
        source "$(PROJECT_ROOT)/driverframework/L2_device/01_IMU/04_BMI270/Kconfig"
    endmenu

    menu "05 BMI270_PX4 CONFIG"
        source "$(PROJECT_ROOT)/driverframework/L2_device/01_IMU/05_BMI270_px4/Kconfig"
    endmenu
endmenu
```

## driverframework/L2_device/02_RC/01_sbus/Kconfig
```kconfig
config RC_USING_SBUS
    bool "Enable SBUS receiver"
    default n
    help
        Enable Futaba SBUS receiver support (100000 8E2, inverted).

    if RC_USING_SBUS

        config RC_SBUS_UART_NAME
            string "SBUS UART device name"
            default "uart2"
            help
                The UART device name used for SBUS (e.g. uart1/uart2).

        config RC_SBUS_BAUDRATE
            int "SBUS baud rate"
            default 100000
            help
                SBUS uses 100000 baud, 8E2.

        config RC_SBUS_INVERTED
            bool "SBUS signal inverted"
            default y
            help
                SBUS line is inverted by default. Keep enabled unless hardware fixes inversion.

        config RC_SBUS_FAST_FRAME
            bool "Enable fast SBUS frame (approx. 7ms)"
            default n
            help
                Some receivers output fast frames (~7ms). Normal is ~14ms.

        config RC_SBUS_DEBUGPIN_EN
            bool "ENABLE: RC_SBUS_DEBUGPIN_EN"
            default n
            help
                Enable debug pin toggling inside SBUS RX/TX paths.

        config RC_SBUS_THREAD_STACK_SIZE
            int "SBUS Thread Stack Size (bytes)"
            range 1024 8192
            default 2048
            help
                Stack size for the SBUS thread in bytes. Default: 2048.

        config RC_SBUS_THREAD_PRIORITY
            int "SBUS Thread Priority"
            range 1 32
            default 9
            help
                Priority for the SBUS thread. Higher number means higher priority. Default: 7.

        config RC_SBUS_THREAD_TIMESLICE
            int "SBUS Thread Time Slice (ticks)"
            range 1 100
            default 5
            help
                Time slice for the SBUS thread in ticks. Default: 5.

    endif
```

## driverframework/L3_peripheral/40_dmaConfig/Kconfig
```kconfig
menuconfig L3_PERIPHERAL_40_DMA_CONFIG_EN
    bool "Enable: 40 DMA CONFIG"
    default n
    help
        Enable DMA configuration support for DShot and other peripherals

    if L3_PERIPHERAL_40_DMA_CONFIG_EN

        config DMA_CONFIG_DSHOT_EN
            bool "Enable DShot DMA Configuration"
            default n
            help
                Enable DMA configuration for DShot motor driver

    endif
```
