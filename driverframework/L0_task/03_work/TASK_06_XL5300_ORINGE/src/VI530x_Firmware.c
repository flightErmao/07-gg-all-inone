#include "VI530x_Firmware.h"
#include "VI530x_API.h"
#include "VI530x_System_Data.h"

/**
 * @brief 	VI530X 获取固件运行状态
 * @param 	[none] 
 * @return 	[VI530x_Status ]	ret:0-操作成功;other-异常
 */
VI530x_Status Get_VI530x_Download_Firmware_Status(void)
{
	VI530x_Status ret = VI530x_OK;
	uint8_t value = 0;

	ret |= VI530x_IIC_Read_One_Byte(0x08, &value);

	if(0x66 == value || 0xAA == value)
	{
		ret &= ~VI530x_ERROR_FW_FAILURE;
	}
	else
	{
		ret |= VI530x_ERROR_FW_FAILURE;
	}
	return ret;
}

/**
 * @brief 	VI530X 下固件前的配置
 * @param 	[none] 
 * @return 	[VI530x_Status ]	ret:0-操作成功;other-异常
 */
VI530x_Status VI530x_Write_Firmware_PreConfig(void)
{
	VI530x_Status ret = VI530x_OK;
	uint8_t reg_sys_cfg = 0;
	ret |= VI530x_Set_Digital_Clock_Dutycycle();

	ret |= VI530x_IIC_Write_One_Byte(VAN_REG_PW_CTRL, 0x08);

	ret |= VI530x_IIC_Write_One_Byte(VAN_REG_PW_CTRL, 0x0a);

	ret |= VI530x_IIC_Write_One_Byte(VAN_REG_MCU_CFG, 0x06); // 0x02

	ret |= VI530x_IIC_Read_One_Byte(VAN_REG_SYS_CFG, &reg_sys_cfg);

	ret |= VI530x_IIC_Write_One_Byte(VAN_REG_SYS_CFG, reg_sys_cfg | (0x01 << 0));

	ret |= VI530x_IIC_Write_One_Byte(VAN_REG_CMD, 0x01);

	ret |= VI530x_IIC_Write_One_Byte(VAN_REG_SIZE, 0x02);

	ret |= VI530x_IIC_Write_One_Byte(VAN_REG_SCRATCH_PAD_BASE + 0x00, 0x00);

	ret |= VI530x_IIC_Write_One_Byte(VAN_REG_SCRATCH_PAD_BASE + 0x01, 0x00);

	return ret;
}

/**
 * @brief 	VI530X 写完固件后的配置
 * @param 	[none] 
 * @return 	[VI530x_Status ]	ret:0-操作成功;other-异常
 */
VI530x_Status VI530x_Write_Firmware_Post_Config(void)
{
	VI530x_Status ret = VI530x_OK;
	//#define VI530x_POWER_MANAGE       1
	if (VI530x_Cali_Data.VI530x_Power_Manage_Status)
	{
			//开启电源管理模式
			ret |= VI530x_IIC_Write_One_Byte(VAN_REG_SYS_CFG, 0x0C);
	}
	else
	{
			//关闭启电源管理模式
			ret |= VI530x_IIC_Write_One_Byte(VAN_REG_SYS_CFG, 0x08);
	}

	ret |= VI530x_IIC_Write_One_Byte(VAN_REG_MCU_CFG, 0x06);

	ret |= VI530x_IIC_Write_One_Byte(VAN_REG_AO_DOMAIN, 0xA0);

	ret |= VI530x_IIC_Write_One_Byte(VAN_REG_AO_DOMAIN, 0x80);

	ret |= VI530x_IIC_Write_One_Byte(VAN_REG_MCU_CFG, 0x07); // 0x03

	ret |= VI530x_IIC_Write_One_Byte(VAN_REG_PW_CTRL, 0x02);

	ret |= VI530x_IIC_Write_One_Byte(VAN_REG_PW_CTRL, 0x00);

	return ret;
}

/**
 * @brief 	VI530X 写固件,长度不超32byte
 * @param 	[uint8_t] *firmware固件数据
 * @param 	[uint8_t] len:数据长度
 * @return 	[VI530x_Status ]	ret:0-操作成功;other-异常
 */
static VI530x_Status VI530x_WriteFirmwareXByte(uint8_t *tdata, uint8_t len)
{
	VI530x_Status ret = VI530x_OK;
	uint8_t cmd_size[2] = {0x00};

	if (len > 32)
		return VI530x_ERROR;

	cmd_size[0] = VAN_WRITEFW_CMD;
	cmd_size[1] = len;

	ret |= VI530x_IIC_Write_X_Bytes(VAN_REG_CMD, cmd_size, 2);
	ret |= VI530x_IIC_Write_X_Bytes(VAN_REG_SCRATCH_PAD_BASE, tdata, len);

	return ret;
}

/**
 * @brief 	VI530X 写固件
 * @param 	[uint8_t] *Firmware_buff：固件数据地址
 * @param 	[uint16_t] size：固件长度
 * @return 	[VI530x_Status ]	ret:0-操作成功;other-异常
 */

VI530x_Status VI530x_Download_Firmware(uint8_t *Firmware_buff, uint16_t size)
{
	VI530x_Status ret = VI530x_OK;
	uint8_t page = 0;
	uint8_t page_buf[32] = {0x00};
	//uint8_t temp_buff[2];
	uint8_t i = 0;

	ret |= VI530x_Write_Firmware_PreConfig();

	while (size >= 32)
	{
		for (i = 0; i < 32; i++)
		{
			page_buf[i] = *(Firmware_buff + page * 32 + i);
		}
		ret |= VI530x_WriteFirmwareXByte(page_buf, 32);
		if (ret != VI530x_OK)
		{
		#ifdef Debug_Mode
			printf("VI530x download failed! ret is %x, page is %x\r\n", ret,page);
		#endif
			return VI530x_ERROR_FW_FAILURE; //返回错误状态
		}

		size -= 32;
		page++;
		//写入帧与帧之间必须间隔10us以上
		VI530x_Delay_Ms(1);
	}

	if (size > 0)
	{

		for (i = 0; i < size; i++)
		{
			page_buf[i] = *(Firmware_buff + page * 32 + i);
		}

		ret |= VI530x_WriteFirmwareXByte(page_buf, size);
		if (ret != VI530x_OK)
		{
		#ifdef Debug_Mode
			printf("VI530x download failed! ret is %x, page is %x\r\n", ret,page);
		#endif
			return VI530x_ERROR_FW_FAILURE; //返回错误状态
		}
	}

	ret |= VI530x_Write_Firmware_Post_Config();
	//此延时是必须的，具体可以改
	VI530x_Delay_Ms(100);
	ret |= Get_VI530x_Download_Firmware_Status();		
	
	//根据方案写入
	//ret |= VI530x_Bvd_Add(3);
	ret |= VI530x_Get_Sys_Histogram_MA_Window_Data(page_buf);
	VI530x_Cali_Data.VI530x_MA_Sum = page_buf[8];
	return ret;
}

/**
 * @brief 	VI530X 固件存放的数据
 */
const uint8_t VI5300_M31_firmware_buff[8192] = 
{ 
//VI530x-M31_G01_R_V5.30.hex
0x02, 0x16, 0x10, 0xc2, 0x8c, 0xd2, 0xd5, 0x32, 0x00, 0x00, 0x00, 0x02, 0x00, 0x03, 0x53, 0x91, 
0xef, 0x32, 0x00, 0x02, 0x15, 0x6a, 0x7b, 0x00, 0x7d, 0x00, 0x7c, 0x02, 0xe4, 0xff, 0xa9, 0x07, 
0x75, 0x97, 0x04, 0x8c, 0xd2, 0x8d, 0xd3, 0x8a, 0xd4, 0x8b, 0xd5, 0xe5, 0x2c, 0xf5, 0xd6, 0x85, 
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0x96, 0x02, 0x22, 
};

/**
 * @brief 	固件大小
 * @param 	
 * @return 	[uint16_t]	固件数据数组大小
 */
uint16_t FirmwareSize(void)
{
		return sizeof(VI5300_M31_firmware_buff);
}






